/*@!Encoding:936*/
//********************************数据处理函数****************************************//
variables
{
   struct CATARC_DUTDatabase_Messgae
    {
      byte DLC[100];//信号起始位
      dword ID[100];//信号长度
      byte cycletime[10];//信号默认值
      byte method[100];//信号十进制最大值
      byte startbit[10][100];//信号起始位
      byte length[10][100];//信号长度
      byte ini_value[10][100];//信号默认值
    };
}

void ANetT_CANHrecessiveV(char path[],float& V)
{
   int a=0;
   char string0[100];
  
   substr_cpy(CL_frame_ID,"007",0,-1,7);
   substr_cpy(CL_frame_FC,"001",0,-1,7);
   substr_cpy(CL_frame_DL,"1",0,-1,7);
   substr_cpy(CL_frame_DATA[0],path,0,-1,5000);

   
   substr_cpy(CL_frame_ACK,"001",0,-1,7);
   CL_frame_build();
   CL_trans_frame();
   strtod(LC_frame_DATA[0],V);
   putValue(envir_labview_display,"ANetT_CANHdominantV"); 
}

void ANetT_CANLrecessiveV(char path[],float& V)
{
   int a=0;
   char string0[100];
  
   substr_cpy(CL_frame_ID,"007",0,-1,7);
   substr_cpy(CL_frame_FC,"002",0,-1,7);
   substr_cpy(CL_frame_DL,"1",0,-1,7);
   substr_cpy(CL_frame_DATA[0],path,0,-1,5000);

   
   substr_cpy(CL_frame_ACK,"001",0,-1,7);
   CL_frame_build();
   CL_trans_frame();
   strtod(LC_frame_DATA[0],V);
   putValue(envir_labview_display,"ANetT_CANLdominantV");

}

void ANetT_CANHdominantV(char path[],float& V)
{
   int a=0;
   char string0[100];
  
   substr_cpy(CL_frame_ID,"007",0,-1,7);
   substr_cpy(CL_frame_FC,"003",0,-1,7);
   substr_cpy(CL_frame_DL,"1",0,-1,7);
   substr_cpy(CL_frame_DATA[0],path,0,-1,5000);

   
   substr_cpy(CL_frame_ACK,"001",0,-1,7);
   CL_frame_build();
   CL_trans_frame();
  strtod(LC_frame_DATA[0],V);
   putValue(envir_labview_display,"ANetT_CANHdominantV"); 
}

void ANetT_CANLdominantV(char path[],float& V)
{
   int a=0;
   char string0[100];
  
   substr_cpy(CL_frame_ID,"007",0,-1,7);
   substr_cpy(CL_frame_FC,"004",0,-1,7);
   substr_cpy(CL_frame_DL,"1",0,-1,7);
   substr_cpy(CL_frame_DATA[0],path,0,-1,5000);

   
   substr_cpy(CL_frame_ACK,"001",0,-1,7);
   CL_frame_build();
   CL_trans_frame();
  strtod(LC_frame_DATA[0],V);
   putValue(envir_labview_display,"ANetT_CANLdominantV");

}

void ANetT_CANdominant_diffV(char path1[],char path2[],float& V)
{
   int a=0;
   char string0[100];
  
   substr_cpy(CL_frame_ID,"007",0,-1,7);
   substr_cpy(CL_frame_FC,"005",0,-1,7);
   substr_cpy(CL_frame_DL,"2",0,-1,7);
   substr_cpy(CL_frame_DATA[0],path1,0,-1,5000);
   substr_cpy(CL_frame_DATA[1],path2,0,-1,5000);
   
   substr_cpy(CL_frame_ACK,"001",0,-1,7);
   CL_frame_build();
   CL_trans_frame();
  strtod(LC_frame_DATA[0],V);
   putValue(envir_labview_display,"ANetT_CANdiffV"); 
 
}

void ANetT_CANdominant_cmV(char path1[],char path2[],float& V)
{
   int a=0;
   char string0[100];
  
   substr_cpy(CL_frame_ID,"007",0,-1,7);
   substr_cpy(CL_frame_FC,"006",0,-1,7);
   substr_cpy(CL_frame_DL,"2",0,-1,7);
   substr_cpy(CL_frame_DATA[0],path1,0,-1,5000);
   substr_cpy(CL_frame_DATA[1],path2,0,-1,5000);

   
   substr_cpy(CL_frame_ACK,"001",0,-1,7);
   CL_frame_build();
   CL_trans_frame();
  strtod(LC_frame_DATA[0],V);
   putValue(envir_labview_display,"ANetT_CANcmV"); 

}

void ANetT_CANrecessive_diffV(char path1[],char path2[],float& V)
{
   int a=0;
   char string0[100];
  
   substr_cpy(CL_frame_ID,"007",0,-1,7);
   substr_cpy(CL_frame_FC,"007",0,-1,7);
   substr_cpy(CL_frame_DL,"2",0,-1,7);
   substr_cpy(CL_frame_DATA[0],path1,0,-1,5000);
   substr_cpy(CL_frame_DATA[1],path2,0,-1,5000);
   substr_cpy(CL_frame_ACK,"001",0,-1,7);
   CL_frame_build();
   CL_trans_frame();
  strtod(LC_frame_DATA[0],V);
   putValue(envir_labview_display,"ANetT_CANdiffV"); 
 
}

void ANetT_CANrecessive_cmV(char path1[],char path2[],float& V)
{
   int a=0;
   char string0[100];
  
   substr_cpy(CL_frame_ID,"007",0,-1,7);
   substr_cpy(CL_frame_FC,"008",0,-1,7);
   substr_cpy(CL_frame_DL,"2",0,-1,7);
   substr_cpy(CL_frame_DATA[0],path1,0,-1,5000);
   substr_cpy(CL_frame_DATA[1],path2,0,-1,5000);

   
   substr_cpy(CL_frame_ACK,"001",0,-1,7);
   CL_frame_build();
   CL_trans_frame();
  strtod(LC_frame_DATA[0],V);
   putValue(envir_labview_display,"ANetT_CANcmV"); 

}

void ANetT_CANH_CANL_RES_IN(char path[],float& V)//内阻测试波形处理
{
   int a=0;
   char string0[100];
  
   substr_cpy(CL_frame_ID,"007",0,-1,7);
   substr_cpy(CL_frame_FC,"017",0,-1,7);
   substr_cpy(CL_frame_DL,"1",0,-1,7);
   substr_cpy(CL_frame_DATA[0],path,0,-1,5000);
   substr_cpy(CL_frame_ACK,"001",0,-1,7);
   CL_frame_build();
   CL_trans_frame();
   strtod(LC_frame_DATA[0],V);
   putValue(envir_labview_display,"ANetT_CANH_CANL_RES_IN"); 
}

void ANetT_CANH_CANL_RES_diff(char path[],float& V)//内阻测试波形处理
{
   int a=0;
   char string0[100];
  
   substr_cpy(CL_frame_ID,"007",0,-1,7);
   substr_cpy(CL_frame_FC,"018",0,-1,7);
   substr_cpy(CL_frame_DL,"1",0,-1,7);
   substr_cpy(CL_frame_DATA[0],path,0,-1,5000);
   substr_cpy(CL_frame_ACK,"001",0,-1,7);
   CL_frame_build();
   CL_trans_frame();
   strtod(LC_frame_DATA[0],V);
   putValue(envir_labview_display,"ANetT_CANH_CANL_RES_IN"); 
}

void ANetT_MESSAGE_Error_Test(char path[],int channel,float& T_Mag)
{
   int a=0;
   char string0[100];
 
   ltoa(channel,string0,10);
   substr_cpy(CL_frame_ID,"007",0,-1,7);
   substr_cpy(CL_frame_FC,"019",0,-1,7);
   substr_cpy(CL_frame_DL,"2",0,-1,7);
   substr_cpy(CL_frame_DATA[0],path,0,-1,5000);
   substr_cpy(CL_frame_DATA[1],string0,0,-1,5000);
   substr_cpy(CL_frame_ACK,"001",0,-1,7);
   CL_frame_build();
   CL_trans_frame();
   strtod(LC_frame_DATA[0],T_Mag);
   putValue(envir_labview_display,"ANetT_MESSAGE_Error_Test"); 
}

void ANetT_Low_Holdtime_ms(char path[],int Timebase,float& timeMS)
{
   int a=0;
   char string0[100];
   char s1[100];
  
   ltoa(Timebase,s1,10);
   substr_cpy(CL_frame_ID,"007",0,-1,7);
   substr_cpy(CL_frame_FC,"020",0,-1,7);
   substr_cpy(CL_frame_DL,"2",0,-1,7);
   substr_cpy(CL_frame_DATA[0],path,0,-1,5000);
   substr_cpy(CL_frame_DATA[1],s1,0,-1,5000);
   substr_cpy(CL_frame_ACK,"001",0,-1,7);
   CL_frame_build();
   CL_trans_frame();
   strtod(LC_frame_DATA[0],timeMS);
   putValue(envir_labview_display,"ANetT_Low_Holdtime_ms"); 
}

void ANetT_High_Holdtime_ms(char path[],int Timebase,float& timeMS)
{
   int a=0;
   char string0[100];
   char s1[100];
  
   ltoa(Timebase,s1,10);
  
   substr_cpy(CL_frame_ID,"007",0,-1,7);
   substr_cpy(CL_frame_FC,"021",0,-1,7);
   substr_cpy(CL_frame_DL,"2",0,-1,7);
   substr_cpy(CL_frame_DATA[0],path,0,-1,5000);
   substr_cpy(CL_frame_DATA[1],s1,0,-1,5000);
   substr_cpy(CL_frame_ACK,"001",0,-1,7);
   CL_frame_build();
   CL_trans_frame();
   strtod(LC_frame_DATA[0],timeMS);
   putValue(envir_labview_display,"ANetT_High_Holdtime_ms"); 
}

void ANetT_Low_Starttime_ms(char path[],int Timebase,float& timeMS)
{
   int a=0;
   char string0[100];
   char s1[100];
  
   ltoa(Timebase,s1,10);
   substr_cpy(CL_frame_ID,"007",0,-1,7);
   substr_cpy(CL_frame_FC,"022",0,-1,7);
   substr_cpy(CL_frame_DL,"2",0,-1,7);
  
   substr_cpy(CL_frame_DATA[0],path,0,-1,5000);
   substr_cpy(CL_frame_DATA[1],s1,0,-1,5000);
   substr_cpy(CL_frame_ACK,"001",0,-1,7);
   CL_frame_build();
   CL_trans_frame();
   strtod(LC_frame_DATA[0],timeMS);
   putValue(envir_labview_display,"ANetT_Low_Starttime_ms"); 
}

void ANetT_High_Starttime_ms(char path[],int Timebase,float& timeMS)
{
   int a=0;
   char string0[100];
   char s1[100];
  
   ltoa(Timebase,s1,10);
   substr_cpy(CL_frame_ID,"007",0,-1,7);
   substr_cpy(CL_frame_FC,"023",0,-1,7);
   substr_cpy(CL_frame_DL,"2",0,-1,7);
   substr_cpy(CL_frame_DATA[0],path,0,-1,5000);
   substr_cpy(CL_frame_DATA[1],s1,0,-1,5000);
   substr_cpy(CL_frame_ACK,"001",0,-1,7);
   CL_frame_build();
   CL_trans_frame();
   strtod(LC_frame_DATA[0],timeMS);
   putValue(envir_labview_display,"ANetT_High_Starttime_ms"); 
}

//int ANetT_SamplingPoint(char path[],int NumOfDisCyc,int NumOfDis,int& SamplingPoint)//024
//{
//   int a=0;
//   char string0[100];
//   char s1[100];
//   char s2[200];
//  
//   ltoa(NumOfDis,s1,10);
//   ltoa(NumOfDisCyc,s2,10);
//  
//  
//   substr_cpy(CL_frame_ID,"007",0,-1,7);
//   substr_cpy(CL_frame_FC,"024",0,-1,7);
//   substr_cpy(CL_frame_DL,"3",0,-1,7);
//   substr_cpy(CL_frame_DATA[0],path,0,-1,5000);
//   substr_cpy(CL_frame_DATA[1],s1,0,-1,5000);
//   substr_cpy(CL_frame_DATA[2],s2,0,-1,5000);
//   substr_cpy(CL_frame_ACK,"001",0,-1,7);
//   CL_frame_build();
//   CL_trans_frame();
//  
//   SamplingPoint=atol(LC_frame_DATA[0]);
//   putValue(envir_labview_display,"ANetT_SamplingPoint"); 
//   return(SamplingPoint);
//}

void ANetT_SamplingPoint(dword  SP_Errortime[],int& ContinueErrorFrameNum)//024
{
   int  a,Num;

  ContinueErrorFrameNum=0;
  Num=0;
  
   for(a=0;a<20;a++)
  {
    if( 0<(SP_Errortime[a+1]-SP_Errortime[a]) && (SP_Errortime[a+1]-SP_Errortime[a])<50 ) // 50->500us
      Num++;
    else
      {
        if(ContinueErrorFrameNum < Num)
        {ContinueErrorFrameNum = Num; write("ContinueErrorFrameNum=====%d",ContinueErrorFrameNum);}
        else
          {}
        Num=0;
      } 
  }

  write("ContinueErrorFrameNum222222=====%d",ContinueErrorFrameNum);
}

void ANetT_FaultTime_ms(char path[],int Mode,float Level,float Timebase,float& ResultTime)//025
{
   int a=0;
   char string0[100];
   char s1[100];
   char string1[100];
   char string2[100];
  
   ltoa(Mode,string0,10);
   _gcvt(Level,10,string1);
   _gcvt(Timebase,10,string2);

  
   substr_cpy(CL_frame_ID,"007",0,-1,7);
   substr_cpy(CL_frame_FC,"025",0,-1,7);
   substr_cpy(CL_frame_DL,"4",0,-1,7);
   substr_cpy(CL_frame_DATA[0],path,0,-1,5000);
   substr_cpy(CL_frame_DATA[1],string0,0,-1,5000);
   substr_cpy(CL_frame_DATA[2],string1,0,-1,5000);
   substr_cpy(CL_frame_DATA[3],string2,0,-1,5000);

   substr_cpy(CL_frame_ACK,"001",0,-1,7);
   CL_frame_build();
   CL_trans_frame();
   strtod(LC_frame_DATA[0],ResultTime);
   putValue(envir_labview_display,"ANetT_FaultTime_ms"); 
}

void ANetT_FaultTime_CH4(char path[],float Timebase,float& T)//026
{
   int a=0;
   char string0[100];
   char s1[100];
  
   ltoa(Timebase,s1,10);
  
  
   substr_cpy(CL_frame_ID,"007",0,-1,7);
   substr_cpy(CL_frame_FC,"026",0,-1,7);
   substr_cpy(CL_frame_DL,"2",0,-1,7);
   substr_cpy(CL_frame_DATA[0],path,0,-1,5000);
   substr_cpy(CL_frame_DATA[1],s1,0,-1,5000);

   substr_cpy(CL_frame_ACK,"001",0,-1,7);
   CL_frame_build();
   CL_trans_frame();
   strtod(LC_frame_DATA[0],T);
   putValue(envir_labview_display,"T"); 
}

void ANetT_gndcan_time_ms(char path[],float Timebase,float& T)//027
{
   char string0[100];
   char s1[100];
  
   ltoa(Timebase,s1,10);
  
  
   substr_cpy(CL_frame_ID,"007",0,-1,7);
   substr_cpy(CL_frame_FC,"027",0,-1,7);
   substr_cpy(CL_frame_DL,"2",0,-1,7);
   substr_cpy(CL_frame_DATA[0],path,0,-1,5000);
   substr_cpy(CL_frame_DATA[1],s1,0,-1,5000);

   substr_cpy(CL_frame_ACK,"001",0,-1,7);
   CL_frame_build();
   CL_trans_frame();
   strtod(LC_frame_DATA[0],T);
   putValue(envir_labview_display,"T"); 
}

void ANetT_ErrFrameCount(char path[],int channel,float& T_Mag,float& T_Error)//028
{
   char s1[100];
  
   ltoa(channel,s1,10);
  
   substr_cpy(CL_frame_ID,"007",0,-1,7);
   substr_cpy(CL_frame_FC,"028",0,-1,7);
   substr_cpy(CL_frame_DL,"2",0,-1,7);
   substr_cpy(CL_frame_DATA[0],path,0,-1,5000);
   substr_cpy(CL_frame_DATA[1],s1,0,-1,5000);

   substr_cpy(CL_frame_ACK,"001",0,-1,7);
   CL_frame_build();
   CL_trans_frame();
   strtod(LC_frame_DATA[0],T_Mag);
   strtod(LC_frame_DATA[1],T_Error); 
}

void ANetT_first_frame(char path[],float& Time,dword& ID)//029
{
   char s1[100];
  
   substr_cpy(CL_frame_ID,"007",0,-1,7);
   substr_cpy(CL_frame_FC,"029",0,-1,7);
   substr_cpy(CL_frame_DL,"1",0,-1,7);
   substr_cpy(CL_frame_DATA[0],path,0,-1,5000);
  
   substr_cpy(CL_frame_ACK,"001",0,-1,7);
   CL_frame_build();
   CL_trans_frame();
   strtod(LC_frame_DATA[0],Time);
   strtoul(LC_frame_DATA[1],ID);
}

void ANetT_cycle_frame(char path[],dword ID[],int ID_N,float& Time)//030
{
   int i=0;
   char s1[1000];
   char s2[1000];
  
  substr_cpy(s1," ",0,-1,7);substr_cpy(s2," ",0,-1,7);
  
  
  
   for(i;i<ID_N;i++)
   {
     strncat(s2,"0x",100);
     ltoa(ID[i],s1,16);
     strncat(s2,s1,100);
   }
   substr_cpy(CL_frame_ID,"007",0,-1,7);
   substr_cpy(CL_frame_FC,"030",0,-1,7);
   substr_cpy(CL_frame_DL,"2",0,-1,7);
   substr_cpy(CL_frame_DATA[0],path,0,-1,5000);
   substr_cpy(CL_frame_DATA[1],s2,0,-1,5000);
  
   substr_cpy(CL_frame_ACK,"001",0,-1,7);
   CL_frame_build();
   CL_trans_frame();
   strtod(LC_frame_DATA[0],Time);
}

void ANetT_NetLoc_awaketime(char path[],dword awakeID,dword respondID,float& Time,float& Firstbyte,float& FirstID,float& FirstIsNetM)//031
{
   int i=0;
   char s1[100];
   char s2[100];
   char s3[100];
   char s4[100];
  
  substr_cpy(s1," ",0,-1,7);substr_cpy(s2," ",0,-1,7);substr_cpy(s3," ",0,-1,7);
  substr_cpy(s4," ",0,-1,7);  
  
   strncat(s1,"0x",100);
   ltoa(awakeID,s3,16);
   strncat(s1,s3,100);
   strncat(s2,"0x",100);
   ltoa(respondID,s4,16);
   strncat(s2,s4,100);

   substr_cpy(CL_frame_ID,"007",0,-1,7);
   substr_cpy(CL_frame_FC,"031",0,-1,7);
   substr_cpy(CL_frame_DL,"3",0,-1,7);
   substr_cpy(CL_frame_DATA[0],path,0,-1,5000);
   substr_cpy(CL_frame_DATA[1],s1,0,-1,5000);
   substr_cpy(CL_frame_DATA[2],s2,0,-1,5000);
  
   substr_cpy(CL_frame_ACK,"001",0,-1,7);
   CL_frame_build();
   CL_trans_frame();
   strtod(LC_frame_DATA[0],Time);
   strtod(LC_frame_DATA[1],Firstbyte);
   strtod(LC_frame_DATA[2],FirstID);
   strtod(LC_frame_DATA[3],FirstIsNetM);
}

void ANetT_standard_frame(char path[],char returnID[],float& record)//032
{
   int i=0;
   char s1[1000];
  substr_cpy(s1," ",0,-1,5000); 
  
   substr_cpy(CL_frame_ID,"007",0,-1,7);
   substr_cpy(CL_frame_FC,"032",0,-1,7);
   substr_cpy(CL_frame_DL,"1",0,-1,7);
   substr_cpy(CL_frame_DATA[0],path,0,-1,5000);
  
   substr_cpy(CL_frame_ACK,"001",0,-1,7);
   CL_frame_build();
   CL_trans_frame();
   substr_cpy(returnID,LC_frame_DATA[0],0,-1,5000);
   strtod(LC_frame_DATA[1],record);
}

void ANetT_standard_ID(char path[],dword standardID[],int ID_N,char returnID[],float& record)//033
{
   int i=0;
   int j=0;
   char s1[1000];
   char s2[1000];
  
  substr_cpy(s1," ",0,-1,5000);substr_cpy(s2," ",0,-1,5000);
  
  
   for(j=0;j<ID_N;j++)
   {
     strncat(s1,"0x",1000);
     ltoa(standardID[j],s2,16);
     strncat(s1,s2,1000);
   }
   write("s1==要检测ID===%s",s1);
   substr_cpy(CL_frame_ID,"007",0,-1,7);
   substr_cpy(CL_frame_FC,"033",0,-1,7);
   substr_cpy(CL_frame_DL,"2",0,-1,7);
   substr_cpy(CL_frame_DATA[0],path,0,-1,5000);
   substr_cpy(CL_frame_DATA[1],s1,0,-1,5000);
   substr_cpy(CL_frame_ACK,"001",0,-1,7);
   CL_frame_build();
   CL_trans_frame();
   substr_cpy(returnID,LC_frame_DATA[0],0,-1,5000);
   strtod(LC_frame_DATA[1],record);
}

void ANetT_standard_DLC(char path[],dword standardID[],int ID_N,byte standardDLC[],char returnID[],float& record)//034
{
   int i=0;
   int j=0;
   char s1[1000];
   char s2[1000];
   char s3[1000];
   char s4[1000];
  
   substr_cpy(s1,"",0,-1,5000);
   substr_cpy(s2,"",0,-1,5000);
   substr_cpy(s3,"",0,-1,5000);
   substr_cpy(s4,"",0,-1,5000); 
  
     for(j=0;j<ID_N;j++)
   {
     strncat(s1,"0x",1000);
     ltoa(standardID[j],s2,16);
     strncat(s1,s2,1000);
   }
   write("s1==所有ID==%s",s1);
     for(j=0;j<ID_N;j++)
   {
     ltoa(standardDLC[j],s3,16);
     strncat(s4,s3,1000);
   }
  
   write("s4==所有DLC==%s",s4);
   substr_cpy(CL_frame_ID,"007",0,-1,7);
   substr_cpy(CL_frame_FC,"034",0,-1,7);
   substr_cpy(CL_frame_DL,"3",0,-1,7);
   substr_cpy(CL_frame_DATA[0],path,0,-1,5000);
   substr_cpy(CL_frame_DATA[1],s1,0,-1,5000);// 标准ID  
   substr_cpy(CL_frame_DATA[2],s4,0,-1,5000);// 标准DLC
   substr_cpy(CL_frame_ACK,"001",0,-1,7);
   CL_frame_build();
   CL_trans_frame();
   substr_cpy(returnID,LC_frame_DATA[0],0,-1,5000);
   strtod(LC_frame_DATA[1],record);
}

void ANetT_percycle_frame(char path[],dword standardID[],int ID_N,dword standardcycletime[],char returnID[],float& record)//035
{
   int i=0;
   int j=0;
   char s1[1000];
   char s2[1000];
   char s3[1000];
   char s4[1000];

  substr_cpy(s1," ",0,-1,7);substr_cpy(s2," ",0,-1,7);substr_cpy(s3," ",0,-1,7);
  substr_cpy(s4," ",0,-1,7);

     for(j=0;j<ID_N;j++)
   {
     strncat(s1,"0x",1000);
     ltoa(standardID[j],s2,16);
     strncat(s1,s2,1000);
   }
  write("==所有ID====%s",s1);
  
     for(j=0;j<ID_N;j++)
   {
     ltoa(standardcycletime[j],s3,10);
     strncat(s4,s3,1000);
     strncat(s4,"ms",1000);
   }
  write("=所有周期=====%s",s4);
   substr_cpy(CL_frame_ID,"007",0,-1,7);
   substr_cpy(CL_frame_FC,"035",0,-1,7);
   substr_cpy(CL_frame_DL,"3",0,-1,7);
   substr_cpy(CL_frame_DATA[0],path,0,-1,5000);
   substr_cpy(CL_frame_DATA[1],s1,0,-1,5000);// 标准ID  
   substr_cpy(CL_frame_DATA[2],s4,0,-1,5000);// 标准ID周期
   substr_cpy(CL_frame_ACK,"001",0,-1,7);
   CL_frame_build();
   CL_trans_frame();
   substr_cpy(returnID,LC_frame_DATA[0],0,-1,5000);
   strtod(LC_frame_DATA[1],record);
}

void ANetT_BusOff(char path[],int Channel,char Describ[],int& result,float& LastErrortime)//036
{
   char a[1000];
   char string0[10];
   char b[1000];
  
   ltoa(Channel,string0,10);
   substr_cpy(CL_frame_ID,"007",0,-1,7);
   substr_cpy(CL_frame_FC,"036",0,-1,7);
   substr_cpy(CL_frame_DL,"2",0,-1,7);
   substr_cpy(CL_frame_DATA[0],path,0,-1,5000);
   substr_cpy(CL_frame_DATA[1],string0,0,-1,5000);
   substr_cpy(CL_frame_ACK,"001",0,-1,7);
  
   CL_frame_build();
   CL_trans_frame();
   putValue(envir_labview_display,"ANetT_BusOff"); 
  
   substr_cpy(Describ,LC_frame_DATA[0],0,-1,elCount(LC_frame_DATA[0]));
   substr_cpy(a,LC_frame_DATA[1],0,-1,elCount(LC_frame_DATA[1]));
   substr_cpy(b,LC_frame_DATA[2],0,-1,elCount(LC_frame_DATA[2]));
   result=atodbl(a);
   LastErrortime=atodbl(b);
}

void  ANetT_blankbit_rule(char path[],dword standardID[],int ID_N,int signal_N ,byte startbit[][], byte length[][],char returnID[],float& record)//037
{
   int i;
   int j;
  int k;
   char s1[100];
   char s2[100];
   char s3[100];
   char s4[100];
   char s5[100];
   char s6[100];
   for(i=0;i<ID_N;i++)
   {
     strncat(s1,"0x",100);
     ltoa(standardID[i],s2,16);
     strncat(s1,s2,100);
   }
   for(j=0;j<ID_N;j++)
   {
    for (k=0;k<signal_N;k++)
    {
   
     ltoa(startbit[j][k],s3,16);
     strncat(s4,s3,100);
    }
  }
   for(j=0;j<ID_N;j++)
   {
      for (k=0;k<signal_N;k++)
      {
   
     ltoa(length[j][k],s5,16);
     strncat(s6,s5,200);
      }
   }
  

   substr_cpy(CL_frame_ID,"007",0,-1,7);
   substr_cpy(CL_frame_FC,"037",0,-1,7);
   substr_cpy(CL_frame_DL,"4",0,-1,7);
   substr_cpy(CL_frame_DATA[0],path,0,-1,5000);
   substr_cpy(CL_frame_DATA[1],s1,0,-1,5000);
   substr_cpy(CL_frame_DATA[2],s4,0,-1,5000);
   substr_cpy(CL_frame_DATA[3],s6,0,-1,5000);
  
   substr_cpy(CL_frame_ACK,"001",0,-1,7);
   CL_frame_build();
   CL_trans_frame();
   substr_cpy(returnID,LC_frame_DATA[0],0,-1,5000);
   strtod(LC_frame_DATA[1],record);
}

void   ANetT_standard_message(char path[],dword standardID[],int ID_N,int signal_N ,byte startbit[][], byte length[][],byte ini_value[][],char returnID[],float& record)//038
{
   int i;
   int j;
  int k;
   char s1[1000];
   char s2[1000];
   char s3[1000];
   char s4[1000];
   char s5[1000];
   char s6[1000];
   char s7[1000];
   char s8[1000];
   for(i=0;i<ID_N;i++)
   {
     strncat(s1,"0x",1000);
     ltoa(standardID[i],s2,16);
     strncat(s1,s2,1000);
   }
   for(j=0;j<ID_N;j++)
   {
    for (k=0;k<signal_N;k++)
    {
   
     ltoa(startbit[j][k],s3,16);
     strncat(s4,s3,1000);
    }
  }
   
  for(j=0;j<ID_N;j++)
   {
      for (k=0;k<signal_N;k++)
      {
   
     ltoa(length[j][k],s5,16);
     strncat(s6,s5,2000);
      }
   }
  for(j=0;j<ID_N;j++)
   {
      for (k=0;k<signal_N;k++)
      {
   
     ltoa(ini_value[j][k],s7,16);
     strncat(s8,s7,2000);
      }
   }
  

   substr_cpy(CL_frame_ID,"007",0,-1,7);
   substr_cpy(CL_frame_FC,"038",0,-1,7);
   substr_cpy(CL_frame_DL,"4",0,-1,7);
   substr_cpy(CL_frame_DATA[0],path,0,-1,5000);
   substr_cpy(CL_frame_DATA[1],s1,0,-1,5000);
   substr_cpy(CL_frame_DATA[2],s4,0,-1,5000);
   substr_cpy(CL_frame_DATA[3],s6,0,-1,5000);
  
   substr_cpy(CL_frame_ACK,"001",0,-1,7);
   CL_frame_build();
   CL_trans_frame();
   substr_cpy(returnID,LC_frame_DATA[0],0,-1,5000);
   strtod(LC_frame_DATA[1],record);
}

void ANetT_Initial_ID(char path1[],char returnID[])//039
{
   int i=0;
   int j=0;
   char s1[1000];
   char s2[1000];
   char path[1000];
  substr_cpy(path,path1,0,-1,elcount(path));
   substr_cpy(CL_frame_ID,"007",0,-1,7);
   substr_cpy(CL_frame_FC,"039",0,-1,7);
   substr_cpy(CL_frame_DL,"1",0,-1,7);
   substr_cpy(CL_frame_DATA[0],path,0,-1,5000);
  
   substr_cpy(CL_frame_ACK,"001",0,-1,7);
   CL_frame_build();
   CL_trans_frame();
   substr_cpy(returnID,LC_frame_DATA[0],0,-1,5000);
   
}

void ANetT_stop_communication(char path1[],float& timeMS)//040
{
   int a=0;
   char string0[100];
  char path[1000];
  substr_cpy(path,path1,0,-1,elcount(path));
   substr_cpy(CL_frame_ID,"007",0,-1,7);
   substr_cpy(CL_frame_FC,"040",0,-1,7);
   substr_cpy(CL_frame_DL,"1",0,-1,7);
   substr_cpy(CL_frame_DATA[0],path,0,-1,5000);
   substr_cpy(CL_frame_ACK,"001",0,-1,7);
   CL_frame_build();
   CL_trans_frame();
   strtod(LC_frame_DATA[0],timeMS);
   putValue(envir_labview_display,"ANetT_High_Starttime_ms"); 
}

void ANetT_Tbit(char path1[],char path2[],float Timebase,int& result,float Xa[],float Xb[])//041 位精度测试
{
   int a=0;
   char string0[10],string1[10],string2[10];
  
   _gcvt(Timebase,3,string0);
 
   substr_cpy(CL_frame_ID,"007",0,-1,7);
   substr_cpy(CL_frame_FC,"041",0,-1,7);
   substr_cpy(CL_frame_DL,"3",0,-1,7);
   substr_cpy(CL_frame_DATA[0],path1,0,-1,5000);
   substr_cpy(CL_frame_DATA[1],path2,0,-1,5000);
   substr_cpy(CL_frame_DATA[2],string0,0,-1,5000);

  
  
   substr_cpy(CL_frame_ACK,"001",0,-1,7);
   CL_frame_build();
   CL_trans_frame();
   substr_cpy(string1,LC_frame_DATA[0],0,-1,5000);
   for(a=1;a<6;a++)
  {
    substr_cpy(string2,LC_frame_DATA[a],0,-1,5000);
    Xa[a-1]=atodbl(string2);    
  }
   for(a=6;a<11;a++)
  {
    substr_cpy(string2,LC_frame_DATA[a],0,-1,5000);
    Xb[a-6]=atodbl(string2);    
  }  
   result=atol(string1);
   write("result====%d",result);
   write("Xb0==Xb1==Xb2====%f===%f===%f",Xb[0],Xb[1],Xb[2]);
   write("Xa0==Xa1==Xa2====%f===%f===%f",Xa[0],Xa[1],Xa[2]);
   putValue(envir_labview_display,"ANetT_Tbit"); 
}

void ANetT_BusOff_FirstT(char path1[],float Timebase,int baudrate,int NC,char ResultExplain[],int& result,float& bit)//037 busoff示波器
{
   int a=0;
   char string0[10],string1[10],string2[10],string3[10],string4[10],string5[10];
  
   _gcvt(Timebase,3,string0);ltoa(baudrate,string1,10);ltoa(NC,string2,10);
 
   substr_cpy(CL_frame_ID,"007",0,-1,7);
   substr_cpy(CL_frame_FC,"037",0,-1,7);
   substr_cpy(CL_frame_DL,"6",0,-1,7);
   substr_cpy(CL_frame_DATA[0],path1,0,-1,5000);
   substr_cpy(CL_frame_DATA[1],string0,0,-1,5000);
   substr_cpy(CL_frame_DATA[2],string1,0,-1,5000);
   substr_cpy(CL_frame_DATA[3],string2,0,-1,5000);
    
   substr_cpy(CL_frame_ACK,"001",0,-1,7);
   CL_frame_build();
   CL_trans_frame();
   substr_cpy(ResultExplain,LC_frame_DATA[0],0,-1,5000);
   substr_cpy(string4,LC_frame_DATA[1],0,-1,5000);
   substr_cpy(string5,LC_frame_DATA[2],0,-1,5000);
   result=atol(string4);
   bit=atodbl(string5);
   putValue(envir_labview_display,"ANetT_BusOff_FirstT"); 
}

void ANetT_Symmetry(char path[],int Timebase,float& Startpoint,float& Endpoint,float& BitV)//042 对称性测试
{
   char string0[10];
   char result0[20],result1[20],result2[20];
  
   _gcvt(Timebase,3,string0);
 
   substr_cpy(CL_frame_ID,"007",0,-1,7);
   substr_cpy(CL_frame_FC,"042",0,-1,7);
   substr_cpy(CL_frame_DL,"2",0,-1,7);
   substr_cpy(CL_frame_DATA[0],path,0,-1,5000);//路径
   substr_cpy(CL_frame_DATA[1],string0,0,-1,5000);//Timebase
   substr_cpy(CL_frame_ACK,"001",0,-1,7);
   CL_frame_build();
   CL_trans_frame();
   substr_cpy(result0,LC_frame_DATA[0],0,-1,5000);
   substr_cpy(result1,LC_frame_DATA[1],0,-1,5000);
   substr_cpy(result2,LC_frame_DATA[2],0,-1,5000);

   Startpoint=atodbl(result0);  
   Endpoint=atodbl(result1);
   BitV=atodbl(result2);

   putValue(envir_labview_display,"ANetT_Tbit"); 
}

void ANetT_NetLoc_FrameContinueSend(char path[],dword awakeID,float& Time)//043 休眠前应用数据帧持续发送时间
{
   int i=0;
   char s1[100];
   char s3[100];

  
   strncat(s1,"0x",elcount(s1));
   ltoa(awakeID,s3,16);
   strncat(s1,s3,elcount(s1));


   substr_cpy(CL_frame_ID,"007",0,-1,7);
   substr_cpy(CL_frame_FC,"043",0,-1,7);
   substr_cpy(CL_frame_DL,"2",0,-1,7);
   substr_cpy(CL_frame_DATA[0],path,0,-1,5000);
   substr_cpy(CL_frame_DATA[1],s1,0,-1,5000);

  
   substr_cpy(CL_frame_ACK,"001",0,-1,7);
   CL_frame_build();
   CL_trans_frame();
   strtod(LC_frame_DATA[0],Time);
   strncpy(s1, "", 10);strncpy(s3, "", 10);

}

void ANetT_NetLoc_CoreWorkBeforeSleep(char path[],dword awakeID,float& Time)//044 休眠前通讯内核停止等待时间
{
   int i=0;
   char s1[100];
   char s3[100];

  
   strncat(s1,"0x",elcount(s1));
   ltoa(awakeID,s3,16);
   strncat(s1,s3,elcount(s1));


   substr_cpy(CL_frame_ID,"007",0,-1,7);
   substr_cpy(CL_frame_FC,"044",0,-1,7);
   substr_cpy(CL_frame_DL,"2",0,-1,7);
   substr_cpy(CL_frame_DATA[0],path,0,-1,5000);
   substr_cpy(CL_frame_DATA[1],s1,0,-1,5000);

  
   substr_cpy(CL_frame_ACK,"001",0,-1,7);
   CL_frame_build();
   CL_trans_frame();
   strtod(LC_frame_DATA[0],Time); 
   strncpy(s1, "", 10);strncpy(s3, "", 10);
}

void ANetT_first_frame(char path[],float& Time)//045  针对本地唤醒后,首帧数据帧的发送时间
{
   char s1[100];
  
   substr_cpy(CL_frame_ID,"007",0,-1,7);
   substr_cpy(CL_frame_FC,"045",0,-1,7);
   substr_cpy(CL_frame_DL,"1",0,-1,7);
   substr_cpy(CL_frame_DATA[0],path,0,-1,5000);
  
   substr_cpy(CL_frame_ACK,"001",0,-1,7);
   CL_frame_build();
   CL_trans_frame();
   strtod(LC_frame_DATA[0],Time);

}

void ANetT_RiseFallTime(char CANH[],char CANL[],int TimeBase,float& CursorA ,float& CursorB)//046  上升下降时间   返回光标位置
{
   char s0[100];

   ltoa(TimeBase,s0,10);
  
   substr_cpy(CL_frame_ID,"007",0,-1,7);
   substr_cpy(CL_frame_FC,"046",0,-1,7);
   substr_cpy(CL_frame_DL,"3",0,-1,7);
   substr_cpy(CL_frame_DATA[0],CANH,0,-1,5000);
   substr_cpy(CL_frame_DATA[1],CANL,0,-1,5000);
   substr_cpy(CL_frame_DATA[2],s0,0,-1,5000);
  
  
   substr_cpy(CL_frame_ACK,"001",0,-1,7);
   CL_frame_build();
   CL_trans_frame();
  
   strtod(LC_frame_DATA[0],CursorA);
   strtod(LC_frame_DATA[1],CursorB);
}
//********************************非数据处理函数****************************************//

void ANetT_MissingACK(char path[],int& result)//047 Missing ACK
{
   char a[100];

   
   substr_cpy(CL_frame_ID,"007",0,-1,7);
   substr_cpy(CL_frame_FC,"047",0,-1,7);
   substr_cpy(CL_frame_DL,"1",0,-1,7);
   substr_cpy(CL_frame_DATA[0],path,0,-1,5000);
   substr_cpy(CL_frame_ACK,"001",0,-1,7);
  
   CL_frame_build();
   CL_trans_frame();
   putValue(envir_labview_display,"ANetT_MissingACK"); 
  
   substr_cpy(a,LC_frame_DATA[0],0,-1,elCount(a));
   result=atodbl(a);
}

void ANetT_Fault_Recover_Time(char path[],float& T)//048
{
   int a=0;
   char string0[100];
  
  
  
   substr_cpy(CL_frame_ID,"007",0,-1,7);
   substr_cpy(CL_frame_FC,"048",0,-1,7);
   substr_cpy(CL_frame_DL,"1",0,-1,7);
   substr_cpy(CL_frame_DATA[0],path,0,-1,5000);

   substr_cpy(CL_frame_ACK,"001",0,-1,7);
   CL_frame_build();
   CL_trans_frame();
   strtod(LC_frame_DATA[0],T);
   putValue(envir_labview_display,"T"); 
}

void ANetT_percycle_FaultRecover(char path[],dword standardID[],int ID_N,dword standardcycletime[],char returnID[],float& record)//049
{
   int i=0;
   int j=0;
   char s1[1000];
   char s2[1000];
   char s3[1000];
   char s4[1000];

  substr_cpy(s1," ",0,-1,5000);substr_cpy(s2," ",0,-1,5000);substr_cpy(s3," ",0,-1,5000);
  substr_cpy(s4," ",0,-1,5000);

     for(j=0;j<ID_N;j++)
   {
     strncat(s1,"0x",1000);
     ltoa(standardID[j],s2,16);
     strncat(s1,s2,1000);
   }
  write("==故障所有ID====%s",s1);
  
     for(j=0;j<ID_N;j++)
   {
     ltoa(standardcycletime[j],s3,10);
     strncat(s4,s3,1000);
     strncat(s4,"ms",1000);
   }
  write("==故障所有ＩＤ的周期====%s",s4);
   substr_cpy(CL_frame_ID,"007",0,-1,7);
   substr_cpy(CL_frame_FC,"049",0,-1,7);
   substr_cpy(CL_frame_DL,"3",0,-1,7);
   substr_cpy(CL_frame_DATA[0],path,0,-1,5000);
   substr_cpy(CL_frame_DATA[1],s1,0,-1,5000);// 标准ID  
   substr_cpy(CL_frame_DATA[2],s4,0,-1,5000);// 标准ID周期
   substr_cpy(CL_frame_ACK,"001",0,-1,7);
   CL_frame_build();
   CL_trans_frame();
   substr_cpy(returnID,LC_frame_DATA[0],0,-1,5000);
   strtod(LC_frame_DATA[1],record);
}

void ANetT_Cycle_Recover_Test(char path[],dword standardID[],int ID_N,dword standardcycletime[],char StartAnalysisTime[],char returnID[],float& record)//053
{
   int i=0;
   int j=0;
   char s1[1000];
   char s2[1000];
   char s3[1000];
   char s4[1000];
   char s5[1000];
  substr_cpy(s1," ",0,-1,5000);substr_cpy(s2," ",0,-1,5000);substr_cpy(s3," ",0,-1,5000);
  substr_cpy(s4," ",0,-1,5000);substr_cpy(s5," ",0,-1,5000);

     for(j=0;j<ID_N;j++)
   {
     strncat(s1,"0x",1000);
     ltoa(standardID[j],s2,16);
     strncat(s1,s2,1000);
   }
  write("==故障所有ID====%s",s1);
  
     for(j=0;j<ID_N;j++)
   {
     ltoa(standardcycletime[j],s3,10);
     strncat(s4,s3,1000);
     strncat(s4,"ms",1000);
   }
  write("==故障所有ＩＤ的周期====%s",s4);
  
  write("==周期容差起始分析位置====00000000000====%s",StartAnalysisTime);
   substr_cpy(CL_frame_ID,"007",0,-1,7);
   substr_cpy(CL_frame_FC,"053",0,-1,7);
   substr_cpy(CL_frame_DL,"4",0,-1,7);
   substr_cpy(CL_frame_DATA[0],path,0,-1,5000);
   substr_cpy(CL_frame_DATA[1],s1,0,-1,5000);// 标准ID  
   substr_cpy(CL_frame_DATA[2],s4,0,-1,5000);// 标准ID周期
   substr_cpy(CL_frame_DATA[3],StartAnalysisTime,0,-1,5000);// 周期容差起始分析位置
   substr_cpy(CL_frame_ACK,"001",0,-1,7);
   CL_frame_build();
   CL_trans_frame();
   substr_cpy(returnID,LC_frame_DATA[0],0,-1,5000);
   strtod(LC_frame_DATA[1],record);
}


void ANetT_MissingACK_Cursors(char CAN_H[],char Channel4[],float& result0,float& result1,float& result2)//050 Missing ACK
{
   char a[100];
   char b[100];
   char c[100];

   substr_cpy(CL_frame_ID,"007",0,-1,7);
   substr_cpy(CL_frame_FC,"050",0,-1,7);
   substr_cpy(CL_frame_DL,"2",0,-1,7);
   substr_cpy(CL_frame_DATA[0],CAN_H,0,-1,5000);
   substr_cpy(CL_frame_DATA[1],Channel4,0,-1,5000);
   substr_cpy(CL_frame_ACK,"001",0,-1,7);
  
   CL_frame_build();
   CL_trans_frame();
   putValue(envir_labview_display,"ANetT_MissingACK_Cursors"); 
  
   substr_cpy(a,LC_frame_DATA[0],0,-1,elCount(a));
   substr_cpy(b,LC_frame_DATA[1],0,-1,elCount(b));
   substr_cpy(c,LC_frame_DATA[2],0,-1,elCount(c));
   result0=atodbl(a);
   result1=atodbl(b);
   result2=atodbl(c);
}

void ANetT_BusOff_Cursors(char CAN_H[],char CAN_L[],float& result0,float& result1,float& result2,float& result3)//051
{
   char a[100];
   char b[100];
   char c[100];
   char d[100];
  
   substr_cpy(CL_frame_ID,"007",0,-1,7);
   substr_cpy(CL_frame_FC,"051",0,-1,7);
   substr_cpy(CL_frame_DL,"2",0,-1,7);
   substr_cpy(CL_frame_DATA[0],CAN_H,0,-1,5000);
   substr_cpy(CL_frame_DATA[1],CAN_L,0,-1,5000);
   substr_cpy(CL_frame_ACK,"001",0,-1,7);
  
   CL_frame_build();
   CL_trans_frame();
   putValue(envir_labview_display,"ANetT_BusOff_Cursors"); 
  
   substr_cpy(a,LC_frame_DATA[0],0,-1,elCount(a));
   substr_cpy(b,LC_frame_DATA[1],0,-1,elCount(b));
   substr_cpy(c,LC_frame_DATA[2],0,-1,elCount(c));
   substr_cpy(d,LC_frame_DATA[3],0,-1,elCount(d));
  
   result0=atodbl(a);
   result1=atodbl(b);
   result2=atodbl(c);
   result3=atodbl(d);
}

void ANetT_standard_ID_FaultRecover(char path[],dword standardID[],int ID_N,char returnID[],float& record)//052
{
   int i=0;
   int j=0;
   char s1[1000];
   char s2[1000];
  
  substr_cpy(s1," ",0,-1,5000);substr_cpy(s2," ",0,-1,5000);
  
  
   for(j=0;j<ID_N;j++)
   {
     strncat(s1,"0x",1000);
     ltoa(standardID[j],s2,16);
     strncat(s1,s2,1000);
   }
   write("s1==故障恢复ID===%s",s1);
   substr_cpy(CL_frame_ID,"007",0,-1,7);
   substr_cpy(CL_frame_FC,"052",0,-1,7);
   substr_cpy(CL_frame_DL,"2",0,-1,7);
   substr_cpy(CL_frame_DATA[0],path,0,-1,5000);
   substr_cpy(CL_frame_DATA[1],s1,0,-1,5000);
   substr_cpy(CL_frame_ACK,"001",0,-1,7);
   CL_frame_build();
   CL_trans_frame();
   substr_cpy(returnID,LC_frame_DATA[0],0,-1,5000);
   strtod(LC_frame_DATA[1],record);
}

void LogFileName_times(char return_filname1[],char main_filename1[],char sub_filename1[],char file_format1[])
{
  char x[10];
  char k[500];
  char ss2[100];
  char return_filname[1000];
  char main_filename[1000];
  char sub_filename[1000];
  char file_format[1000];
  
  
  
  substr_cpy(return_filname,return_filname1,0,-1,elcount(return_filname));
  substr_cpy(main_filename,main_filename1,0,-1,elcount(main_filename));
  substr_cpy(sub_filename,sub_filename1,0,-1,elcount(sub_filename));
  substr_cpy(file_format,file_format1,0,-1,elcount(file_format));
  substr_cpy(k,main_filename,0,-1,5000);
  strncat(k,"\\",5000);
  strncat(k,sub_filename,5000);
  strncat(k,".",5000);
  strncat(k,file_format,5000);
  substr_cpy(return_filname1,k,0,-1,5000);
    
    
 write("return_filname1===========%s",return_filname1);   
}

void LogFileName_times(char return_filname1[],char main_filename1[],char sub_filename1[],char file_format1[],float time)
{
  char x[10];
  char k[500];
  char ss2[100];
  char return_filname[1000];
  char main_filename[1000];
  char sub_filename[1000];
  char file_format[1000];
  
  
  
  substr_cpy(return_filname,return_filname1,0,-1,elcount(return_filname));
  substr_cpy(main_filename,main_filename1,0,-1,elcount(main_filename));
  substr_cpy(sub_filename,sub_filename1,0,-1,elcount(sub_filename));
  substr_cpy(file_format,file_format1,0,-1,elcount(file_format));
  substr_cpy(k,main_filename,0,-1,5000);
  strncat(k,"\\",5000);
  strncat(k,sub_filename,5000);
  strncat(k,"(",5000);
    _gcvt(time,6,x);
    substr_cpy(ss2,x,strlen(x)-1,1,100);
    if(strncmp(".",ss2,1)==0)
    {
      substr_cpy(ss2,x,0,strlen(x)-1,100);
    }
    else
    {
      substr_cpy(ss2,x,0,-1,100);
    }
  strncat(k,ss2,5000);
  strncat(k,")",5000);
  strncat(k,".",5000);
  strncat(k,file_format,5000);
  substr_cpy(return_filname1,k,0,-1,5000);
    
    
 write("return_filname1===========%s",return_filname1);   
}

void LogFileName_times(char return_filname[],char main_filename[],char sub_filename[],char childhood_sub_filename[] ,char file_format[],float time)
{
  char x[10];
  char k[500];
  char ss2[100];
  substr_cpy(k,main_filename,0,-1,5000);
  strncat(k,"\\",5000);
  strncat(k,sub_filename,5000);
  strncat(k,"-",5000);
  strncat(k,childhood_sub_filename,5000);
  strncat(k,"(",5000);

    _gcvt(time,6,x);

    substr_cpy(ss2,x,strlen(x)-1,1,100);
    if(strncmp(".",ss2,1)==0)
    {
      substr_cpy(ss2,x,0,strlen(x)-1,100);
    }
    else
    {
      substr_cpy(ss2,x,0,-1,100);
    }
  
  strncat(k,ss2,5000);
  strncat(k,")",5000);
  strncat(k,".",5000);
  strncat(k,file_format,5000);
  substr_cpy(return_filname,k,0,-1,5000);
    
}

void LogFileName_times(char return_filname1[],char main_filename1[],char sub_filename1[],char file_format1[],float time,char DUTname1[])
{
  char x[10];
  char k[500];
  char ss2[100];
  char return_filname[1000];
  char main_filename[1000];
  char sub_filename[1000];
  char file_format[1000];
  char DUTname[1000];
  substr_cpy(return_filname,return_filname1,0,-1,elcount(return_filname));
  substr_cpy(main_filename,main_filename1,0,-1,elcount(main_filename));
  substr_cpy(sub_filename,sub_filename1,0,-1,elcount(sub_filename));
  substr_cpy(file_format,file_format1,0,-1,elcount(file_format));
  substr_cpy(DUTname,DUTname1,0,-1,elcount(DUTname));
  substr_cpy(k,main_filename,0,-1,5000);
  strncat(k,"\\",5000);
  strncat(k,sub_filename,5000);
  strncat(k,"(",5000);
    _gcvt(time,6,x);
    substr_cpy(ss2,x,strlen(x)-1,1,100);
    if(strncmp(".",ss2,1)==0)
    {
      substr_cpy(ss2,x,0,strlen(x)-1,100);
    }
    else
    {
      substr_cpy(ss2,x,0,-1,100);
    }
  strncat(k,ss2,5000);
  strncat(k,")",5000);
    strncat(k,"(",5000);
    strncat(k,DUTname,5000);
    strncat(k,")",5000);
  strncat(k,".",5000);
  strncat(k,file_format,5000);
  substr_cpy(return_filname1,k,0,-1,5000);
}

void Wrost_Result_Find(int selected,float Data[],int mod,float Standard,int& WorstNum)//最差值float
{
  int   i=0;
  float mid=0;
  float wrostK=0;
  float wrostData=0;
 
  if(mod==2)//离标准最远
  {
    wrostK=abs(Data[0]-Standard);
    wrostData=Data[0];
    WorstNum=0;
    for(i=0;i<abs(global_array_selected[selected-1]);i++)
    {
       if(wrostK<abs(Data[i]-Standard))
       {
        wrostK=abs(Data[i]-Standard);
        wrostData=Data[i];
        write("D===========%f",Data[i]);
        WorstNum=i;
       } 
    }
   
  }
}

void Wrost_Result_Num_Find(int num,float Data[],int mod,float Standard,int& WorstNum)//最差值float
{
  int   i=0;
  float mid=0;
  float wrostK=0;
  float wrostData=0;
 
  if(mod==2)//离标准最远
  {
    wrostK=abs(Data[0]-Standard);
    wrostData=Data[0];
    WorstNum=0;
    for(i=0;i<num;i++)
    {
       if(wrostK<abs(Data[i]-Standard))
       {
        wrostK=abs(Data[i]-Standard);
        wrostData=Data[i];
        WorstNum=i;
       } 
    }
  }
}

void Wrost_Result_Find(int selected,float Data[],int mod,int& WorstNum)//最差值
{
  int i;
  float wrost;
  
  wrost=Data[0];
  WorstNum=0;
  if(mod==0)//最小值
  {
    WorstNum=0;
    for(i=0;i<abs(global_array_selected[selected-1]);i++)
    {
     if(wrost>Data[i])
     {
      wrost=Data[i];
      WorstNum=i;
     }
    }
  }
  else if(mod==1)//最大值
  {
    WorstNum=0;
    for(i=0;i<abs(global_array_selected[selected-1]);i++)
    {
     if(wrost<Data[i])
     {
      wrost=Data[i];
      WorstNum=i;
     }
    }
  }
}

void Wrost_Result_Find(int selected,int Data[],int mod,int& WorstNum)//最差值
{
  int i;
  float wrost;
  
  wrost=Data[0];

  if(mod==0)//最小值
  {
    WorstNum=0;
    for(i=0;i<abs(global_array_selected[selected-1]);i++)
    {
     if(wrost>Data[i])
     {
      wrost=Data[i];
      WorstNum=i;
     }
    }
  }
  else if(mod==1)//最大值
  {
    WorstNum=0;
    for(i=0;i<abs(global_array_selected[selected-1]);i++)
    {
     if(wrost<Data[i])
     {
      wrost=Data[i];
      WorstNum=i;
     }
    }
  }
}

void Wrost_Result_Find(int selected,float Data[],int mod,float& average)//平均值
{
  int   i;
  float Average=0;

  if(mod==3)//平均值
  {

    for(i=0;i<abs(global_array_selected[selected-1]);i++)
    {
      Average=Data[i]+Average;
      average=Average;

    }
  }
  
}

void Wrost_Result_Find(int selected,long Data[],int mod,float Standard,int& WorstNum)//最差值long
{
  int   i;
  float mid=0;
  float wrostK=0;
  float wrostData=0;
 
  if(mod==2)//离标准最远
  {
    wrostK=abs(Data[0]-Standard);
    wrostData=Data[0];
    WorstNum=0;
    for(i=0;i<abs(global_array_selected[selected-1]);i++)
    {
     if(wrostK<abs(Data[i]-Standard))
     {
      wrostK=abs(Data[i]-Standard);
      wrostData=Data[i];
      write("D===========%f",Data[i]);
      WorstNum=i;
     }
    }
  }
}

void Wrost_Result_Find(int selected,byte Data[],int mod,float Standard,int& WorstNum)//最差值byte
{
  int   i;
  float mid=0;
  float wrostK=0;
  float wrostData=0;
 
  if(mod==2)//离标准最远
  {
    wrostK=abs(Data[0]-Standard);
    wrostData=Data[0];
    WorstNum=0;
    for(i=0;i<abs(global_array_selected[selected-1]);i++)
    {
       if(wrostK<abs(Data[i]-Standard))
       {
        wrostK=abs(Data[i]-Standard);
        wrostData=Data[i];
        write("D===========%f",Data[i]);
        WorstNum=i;
       }

    }
  }
}

void ANetT_setLogFileName(char fileName1[])
{
  int i;
  float mid=0;
  float wrostK=0;
  float wrostData=0;
  char fileName[1000];
  substr_cpy(fileName,fileName1,0,-1,elcount(fileName));
  stopLogging();
  setLogFileName(fileName);
  Testwaitfortimeout(2000);
}

void ANetT_stopLogFileName()
{
  stopLogging();
  setLogFileName("C:\\Users\\C226\\Desktop\\BB22222.asc");
  
  startLogging();
  Testwaitfortimeout(2000);
  stopLogging();
}

void ANetT_ResultDescribe(char Describe1[],float Data1,char AA[])                              //报告描述函数
{
  int  front=-1,i=0;
  char Data_str1[100];
  char frontstr[100];
  char backstr[100];
  char Describe[1000];
  char Variable2[1000];
  
  
  substr_cpy(Describe,Describe1,0,-1,elcount(Describe));
    front=-1;
    _gcvt(Data1,4,Data_str1);
    if(strstr(Data_str1,".")!=-1&&(strstr(Data_str1,".")+1)==strlen(Data_str1))
    {
      substr_cpy(Data_str1,Data_str1,0,strlen(Data_str1)-1,100);
    }
    
    for(i=0;i<50;i++)
    {
       if(strstr(Describe,"%1f")==-1)
      {
        substr_cpy(AA,Describe,0,-1,elcount(Describe));
        break;
      }
       front=strstr(Describe,"%1f"); 
       substr_cpy(Variable2,Describe,0,front,elcount(Describe));
       strncat(Variable2,Data_str1,5000);
       substr_cpy(backstr,Describe,front+3,-1,elcount(Describe));
       strncat(Variable2,backstr,5000);
       substr_cpy(Describe,Variable2,0,-1,elcount(Variable2));
    }
    substr_cpy(AA,Describe,0,-1,elcount(Describe));
}

void ANetT_ResultDescribe(char Describe2[],float Data1,float Data2,char ss[])                  //报告描述函数
{
  int  front=-1,i=0;
  char Data_str1[100];
  char Data_str2[100];
  char frontstr[100];
  char backstr[100];
  char Describe[1000];
  char Variable2[1000];
/*****************************Data1**************************/
  substr_cpy(Describe,Describe2,0,-1,elcount(Describe));
  
    front=-1;
    _gcvt(Data1,4,Data_str1);
    if(strstr(Data_str1,".")!=-1&&(strstr(Data_str1,".")+1)==strlen(Data_str1))
    {
      substr_cpy(Data_str1,Data_str1,0,strlen(Data_str1)-1,100);
    }
    for(i=0;i<50;i++)
    {
       if(strstr(Describe,"%1f")==-1)
      {
        substr_cpy(ss,Describe,0,-1,elcount(ss));
        break;
      }
       front=strstr(Describe,"%1f"); 
       substr_cpy(Variable2,Describe,0,front,elcount(Describe));
       strncat(Variable2,frontstr,5000);
       strncat(Variable2,Data_str1,5000);
       substr_cpy(backstr,Describe,front+3,-1,elcount(Describe));
       strncat(Variable2,backstr,5000);
       substr_cpy(Describe,Variable2,0,-1,elcount(Describe));
    }
/*****************************Data2**************************/
    front=-1;
    _gcvt(Data2,4,Data_str2);
    if(strstr(Data_str2,".")!=-1&&(strstr(Data_str2,".")+1)==strlen(Data_str2))
    {
      substr_cpy(Data_str2,Data_str2,0,strlen(Data_str2)-1,100);
    }
    for(i=0;i<50;i++)
    {
       if(strstr(Describe,"%2f")==-1)
      {
        substr_cpy(ss,Describe,0,-1,elcount(ss));
        break;
      }
       front=strstr(Describe,"%2f"); 
       substr_cpy(Variable2,Describe,0,front,elcount(Describe));
       strncat(Variable2,frontstr,5000);
       strncat(Variable2,Data_str2,5000);
       substr_cpy(backstr,Describe,front+3,-1,elcount(Describe));
       strncat(Variable2,backstr,5000);
       substr_cpy(Describe,Variable2,0,-1,elcount(Describe));
    }
    substr_cpy(ss,Describe,0,-1,elcount(ss));
}

void ANetT_ResultDescribe(char Describe1[],float Data1,float Data2,float Data3,char ss[])      //报告描述函数
{
  int  front=-1,i=0;
  char Data_str1[100];
  char Data_str2[100];
  char Data_str3[100];
  char frontstr[100];
  char backstr[100];
  char Describe[1000];
  char Variable2[1000];
/*****************************Data1**************************/
  substr_cpy(Describe,Describe1,0,-1,elcount(Describe));
    front=-1;
    _gcvt(Data1,4,Data_str1);
    if(strstr(Data_str1,".")!=-1&&(strstr(Data_str1,".")+1)==strlen(Data_str1))
    {
      substr_cpy(Data_str1,Data_str1,0,strlen(Data_str1)-1,100);
    }
    for(i=0;i<50;i++)
    {
       if(strstr(Describe,"%1f")==-1)
      {
        substr_cpy(ss,Describe,0,-1,elcount(ss));
        break;
      }
       front=strstr(Describe,"%1f"); 
       substr_cpy(Variable2,Describe,0,front,elcount(Describe));
       strncat(Variable2,frontstr,5000);
       strncat(Variable2,Data_str1,5000);
       substr_cpy(backstr,Describe,front+3,-1,elcount(Describe));
       strncat(Variable2,backstr,5000);
       substr_cpy(Describe,Variable2,0,-1,elcount(Describe));
    }
/*****************************Data2**************************/
    front=-1;
    _gcvt(Data2,4,Data_str2);
    if(strstr(Data_str2,".")!=-1&&(strstr(Data_str2,".")+1)==strlen(Data_str2))
    {
      substr_cpy(Data_str2,Data_str2,0,strlen(Data_str2)-1,100);
    }
    for(i=0;i<50;i++)
    {
       if(strstr(Describe,"%2f")==-1)
      {
        substr_cpy(ss,Describe,0,-1,elcount(ss));
        break;
      }
       front=strstr(Describe,"%2f"); 
       substr_cpy(Variable2,Describe,0,front,elcount(Describe));
       strncat(Variable2,frontstr,5000);
       strncat(Variable2,Data_str2,5000);
       substr_cpy(backstr,Describe,front+3,-1,elcount(Describe));
       strncat(Variable2,backstr,5000);
       substr_cpy(Describe,Variable2,0,-1,elcount(Describe));
    }
/*****************************Data3**************************/
    front=-1;
    _gcvt(Data3,4,Data_str3);
    if(strstr(Data_str3,".")!=-1&&(strstr(Data_str3,".")+1)==strlen(Data_str3))
    {
      substr_cpy(Data_str3,Data_str3,0,strlen(Data_str3)-1,100);
    }
    for(i=0;i<50;i++)
    {
       if(strstr(Describe,"%3f")==-1)
      {
        substr_cpy(ss,Describe,0,-1,elcount(ss));
        break;
      }
       front=strstr(Describe,"%3f"); 
       substr_cpy(Variable2,Describe,0,front,elcount(Describe));
       strncat(Variable2,frontstr,5000);
       strncat(Variable2,Data_str3,5000);
       substr_cpy(backstr,Describe,front+3,-1,elcount(Describe));
       strncat(Variable2,backstr,5000);
       substr_cpy(Describe,Variable2,0,-1,elcount(Describe));
    }
    substr_cpy(ss,Describe,0,-1,elcount(ss));
}   

void ANetT_DUTDatabase_ID(char DUTName1[],byte DLC[],dword ID[],int& ID_N,int& signal_N,dword cycletime[],byte method[],byte startbit[][],byte length[][],byte ini_value[][])//数据库信息提取完全版
{
   int i,j,k,m=0;
  char DUTName[1000];
 substr_cpy(DUTName,DUTName1,0,-1,elcount(DUTName));
 
 for(i=0;i<T_Clsts[0].T_DUTnumber;i++)
  {
    if(strncmp(DUTName,T_Clsts[0].T_DUT[i].name,100)==0)
    {
      break;
    }
  }
   m=0;
 for(j=0;j<T_Clsts[0].T_DUT[i].Tmsgnumber;j++)
  {
    if(T_Clsts[0].T_DUT[i].T_msg[j].method==0)
   {
      DLC[m]=T_Clsts[0].T_DUT[i].T_msg[j].DLC;//获取DLC
      cycletime[m]=T_Clsts[0].T_DUT[i].T_msg[j].cycletime;//获取周期
      ID[m]=T_Clsts[0].T_DUT[i].T_msg[j].ID;//获取ID
      method[m]=T_Clsts[0].T_DUT[i].T_msg[j].method;//获取ID发送方式
     for(k=0;k<T_Clsts[0].T_DUT[i].T_msg[j].signalnumber;k++)
     {
      startbit[10][k]=T_Clsts[0].T_DUT[i].T_msg[j].Sub_signal[k].startbit;//
      length[10][k]=T_Clsts[0].T_DUT[i].T_msg[j].Sub_signal[k].length;//
      ini_value[10][k]=T_Clsts[0].T_DUT[i].T_msg[j].Sub_signal[k].ini_value;//
     } 
      m++;
   }

  }
  ID_N=m;
  signal_N=k;
}



void ANetT_DUTDatabase_ID(char DUTName1[],dword ID[],int& ID_N,dword cycletime[],byte DLC[])//数据库信息提取ID信息
{
  int i,j,m=0;
  char DUTName[1000];
  
  substr_cpy(DUTName,DUTName1,0,-1,elcount(DUTName));
 for(i=0;i<T_Clsts[0].T_DUTnumber;i++)
  {
    if(strncmp(DUTName,T_Clsts[0].T_DUT[i].name,100)==0)
    {
      break;
    }
  }
  m=0;
 for(j=0;j<T_Clsts[0].T_DUT[i].Tmsgnumber;j++)
  {
    if(T_Clsts[0].T_DUT[i].T_msg[j].method==0)
    {
      DLC[m]=T_Clsts[0].T_DUT[i].T_msg[j].DLC;//获取报文长度
      cycletime[m]=T_Clsts[0].T_DUT[i].T_msg[j].cycletime;//获取周期
      ID[m]=T_Clsts[0].T_DUT[i].T_msg[j].ID;//获取ID 
      m++;

    }

  }
  ID_N=m;
  
}

void ANetT_DUTDatabase_ID(char DUTName1[],dword ID[],int DLC[])//数据库信息提取ID信息
{
   int i,j,m=0,n;
   char DUTName[1000];


  
  
  substr_cpy(DUTName,DUTName1,0,-1,elcount(DUTName));
 for(i=0;i<T_Clsts[0].T_DUTnumber;i++)
  {
    if(strncmp(DUTName,T_Clsts[0].T_DUT[i].name,100)==0)
    {
      break;
    }
  }
  m=0;n=0;
 for(j=0;j<T_Clsts[0].T_DUT[i].Tmsgnumber;j++)
  {
    if(T_Clsts[0].T_DUT[i].T_msg[j].method==0)
    {
      DLC[m]=T_Clsts[0].T_DUT[i].T_msg[j].DLC;//获取报文长度
      ID[m]=T_Clsts[0].T_DUT[i].T_msg[j].ID;//获取ID 
      m++;
    }

  }
//   HightID=ID_O[0];
//   HightDLC=DLC_O[0];
//  for(n=0;n<m;n++)
//  {
//    if(HightID>ID_O[n])
//    {
//      HightID=ID_O[n];
//      HightDLC=DLC_O[n];
//    }
//  }
//    ID=HightID;
//    DLC=HightDLC; 
}

void ANetT_DUTDatabase_ID(char DUTName1[],int& signal_N,byte startbit[][],byte length[][],byte ini_value[][])//数据库信息提取signa信息
{
   int i,j,k,m=0;
  char DUTName[1000];
  substr_cpy(DUTName,DUTName1,0,-1,elcount(DUTName));
 for(i=0;i<T_Clsts[0].T_DUTnumber;i++)
  {
    if(strncmp(DUTName,T_Clsts[0].T_DUT[i].name,100)==0)
    {
      break;
    }
  }
 for(j=0;j<T_Clsts[0].T_DUT[i].Tmsgnumber;j++)
  {
    
    for(k=0;k<T_Clsts[0].T_DUT[i].T_msg[j].signalnumber;k++)
    {
      startbit[10][0]=T_Clsts[0].T_DUT[i].T_msg[j].Sub_signal[k].startbit;//
      length[10][k]=T_Clsts[0].T_DUT[i].T_msg[j].Sub_signal[k].length;//
      ini_value[10][k]=T_Clsts[0].T_DUT[i].T_msg[j].Sub_signal[k].ini_value;//
    }
  }
  signal_N=k-1;
  
}

//void ANetT_NetAwake_ID(dword ID[],int& Num)//网络唤醒帧提取汇总
//{
//  int i;
//  char DUTName[1000];
//
// for(i=0;i<100;i++)
//  {
//    if(T_online_DUT[0].T_online_Netevent[i].NeteventID!=0)
//    {
//        ID[i]=T_online_DUT[0].T_online_Netevent[i].NeteventID;
//    }
//    else
//    {
//      break;
//    }
//  }
//     Num=i;
//     write("===========%d",Num);
//}

//void ANetT_NetAwake_ID(int& Num)//网络唤醒帧提取汇总
//{
//  int i;
//  char DUTName[1000];
//
// for(i=0;i<100;i++)
//  {
//    if(T_online_DUT[0].T_online_Netevent[i].NeteventID!=0)
//    {
//        
//    }
//    else
//    {
//      break;
//    }
//  }
//     Num=i;
//     write("===========%d",Num);
//}

void ANetT_NetAwake_NonNetID(char DUTName1[],dword DataID[],int& Num)//数据帧提取汇总
{
  int i,j;
  char DUTName[100];
  Num=0;

  substr_cpy(DUTName,DUTName1,0,-1,elcount(DUTName));

 for(i=0;i<T_Clsts[0].T_DUTnumber;i++)
  {
    if(strncmp(DUTName,T_Clsts[0].T_DUT[i].name,100)==0)
    {
      break;
    }
  }
  
 for(j=0;j<T_Clsts[0].T_DUT[i].Rmsgnumber;j++)
  {
    if(T_Clsts[0].T_DUT[i].R_msg[j].ID!=0 && T_Clsts[0].T_DUT[i].R_msg[j].method==0)
    {
        if(T_Clsts[0].T_DUT[i].R_msg[j].ID>=0x600 && T_Clsts[0].T_DUT[i].R_msg[j].ID<=0x650)
        {}
        else
        {
          DataID[Num]=T_Clsts[0].T_DUT[i].R_msg[j].ID;
          Num++;
        }
    }
 }
}

void ANetT_DUTNetFrame_ID(char DUTName1[],dword& ID,byte& DLC)//自身网络唤醒帧提取
{
   int i,j;
   char DUTName[1000];
  
 substr_cpy(DUTName,DUTName1,0,-1,elcount(DUTName));
 for(i=0;i<T_Clsts[0].T_DUTnumber;i++)
  {
    if(strncmp(DUTName,T_Clsts[0].T_DUT[i].name,100)==0)
    {
      break;
    }
  }
  for(j=0;j<T_Clsts[0].T_DUT[i].Tmsgnumber;j++)
  {    

    if(T_Clsts[0].T_DUT[i].T_msg[j].ID>=0x600 && T_Clsts[0].T_DUT[i].T_msg[j].ID<0x655 && T_Clsts[0].T_DUT[i].T_msg[j].method==0)
    {
      ID=T_Clsts[0].T_DUT[i].T_msg[j].ID;
      DLC=T_Clsts[0].T_DUT[i].T_msg[j].DLC;
      break;
    }
  }
}

void ANetT_OtherDUTNetFrame_ID(char DUTName1[],dword& ID)//其他某个样机网络唤醒帧提取
{
   int i,j;
   char DUTName[1000];
  byte IDfinded;
IDfinded=0;
 substr_cpy(DUTName,DUTName1,0,-1,elcount(DUTName));

 for(i=0;i<T_Clsts[0].T_DUTnumber;i++)
  {
    if(strncmp(DUTName,T_Clsts[0].T_DUT[i].name,100)==0)
    {
      break;
    }
  }
  for(j=0;j<T_Clsts[0].T_DUT[i].Rmsgnumber;j++)
  {    
    if(T_Clsts[0].T_DUT[i].R_msg[j].ID>=0x600 && T_Clsts[0].T_DUT[i].R_msg[j].ID<0x655 && T_Clsts[0].T_DUT[i].R_msg[j].method==0)
    {
      ID=T_Clsts[0].T_DUT[i].R_msg[j].ID;
      IDfinded=1;
      break;
    }
  }
  if(IDfinded==0)
	{ID=0X620;}
}

void ANetT_Result_AnStandard(int selected,float Data[],int standard,int& WorstNum)//不符合标准
{
  int i;
  float wrost;
  
  wrost=Data[0];
  WorstNum=0;
  
    for(i=0;i<abs(global_array_selected[selected-1]);i++)
  {
     if(Data[i]!=standard)
     {
       wrost=Data[i];
       WorstNum=i;
       break;
     }
  }
  
}



void ANetT_DUTDatabase_CycleID(char DUTName1[],byte DLC[],dword ID[],int& ID_N,int signal_N[],dword cycletime[],byte check_method[][],byte startbit[][],byte length[][],byte ini_value[][])//数据库信息提取完全版
{
   int i,j,k,m=0;
   char DUTName[100];
  
  
  
  
  substr_cpy(DUTName,DUTName1,0,-1,elcount(DUTName));
 
  for(i=0;i<T_Clsts[0].T_DUTnumber;i++)
   {
      if(strncmp(DUTName,T_Clsts[0].T_DUT[i].name,100)==0)
      {
        break;
      }

   }
   m=0;
  
 for(j=0;j<T_Clsts[0].T_DUT[i].Tmsgnumber;j++)
   {
      if(T_Clsts[0].T_DUT[i].T_msg[j].method==0)
      { 
        DLC[m]=T_Clsts[0].T_DUT[i].T_msg[j].DLC;//获取DLC
        cycletime[m]=T_Clsts[0].T_DUT[i].T_msg[j].cycletime;//获取周期
        ID[m]=T_Clsts[0].T_DUT[i].T_msg[j].ID;//获取ID
         for(k=0;k<T_Clsts[0].T_DUT[i].T_msg[j].signalnumber;k++)
          {
            startbit[m][k]=T_Clsts[0].T_DUT[i].T_msg[j].Sub_signal[k].startbit;//
            length[m][k]=T_Clsts[0].T_DUT[i].T_msg[j].Sub_signal[k].length;//
            //write("length[%d][%d]=======%d",m,k,length[j][k]);
            ini_value[m][k]=T_Clsts[0].T_DUT[i].T_msg[j].Sub_signal[k].ini_value;//
            check_method[m][k]=T_Clsts[0].T_DUT[i].T_msg[j].Sub_signal[k].rout_method;//rolling counter 和checksum 用  
          } 
        signal_N[m]=k;
        m++;
      }
   }
  
  ID_N=m;
}

void ANetT_DUTDatabase_ID(char DUTName1[],byte DLC[],dword ID[],int& ID_N,int signal_N[],dword cycletime[],byte check_method[][],byte startbit[][],byte length[][],byte ini_value[][],int& Index_ECU)//数据库信息提取完全版
{
   int i,j,k,m=0;
   char DUTName[100];
  
  
  
  
  substr_cpy(DUTName,DUTName1,0,-1,elcount(DUTName));
 
  for(i=0;i<T_Clsts[0].T_DUTnumber;i++)
   {
      if(strncmp(DUTName,T_Clsts[0].T_DUT[i].name,100)==0)
      {
        Index_ECU=i;
        break;
      }

   }
   m=0;
  
 for(j=0;j<T_Clsts[0].T_DUT[i].Tmsgnumber;j++)
   {
      if(T_Clsts[0].T_DUT[i].T_msg[j].method==0)
      { 
        DLC[m]=T_Clsts[0].T_DUT[i].T_msg[j].DLC;//获取DLC
        cycletime[m]=T_Clsts[0].T_DUT[i].T_msg[j].cycletime;//获取周期
        ID[m]=T_Clsts[0].T_DUT[i].T_msg[j].ID;//获取ID
         for(k=0;k<T_Clsts[0].T_DUT[i].T_msg[j].signalnumber;k++)
          {
            startbit[m][k]=T_Clsts[0].T_DUT[i].T_msg[j].Sub_signal[k].startbit;//
            length[m][k]=T_Clsts[0].T_DUT[i].T_msg[j].Sub_signal[k].length;//
            //write("length[%d][%d]=======%d",m,k,length[j][k]);
            ini_value[m][k]=T_Clsts[0].T_DUT[i].T_msg[j].Sub_signal[k].ini_value;//
            check_method[m][k]=T_Clsts[0].T_DUT[i].T_msg[j].Sub_signal[k].rout_method;//rolling counter 和checksum 用  
          } 
        signal_N[m]=k;
        m++;
      }
   }
  
  ID_N=m;
}


int Search1DArray(dword array[],dword element)
{
  int  i,Nummax,Num,state;
  int Serial; 

  Nummax=0;
  state=0;

  while(1)
  {
    if(state==1)
    break;
    else
    {
      Nummax=Nummax+100;
      for(i=0;i<Nummax;i++)
      {
        if(array[i]==0)
        { Num=i;state=1;break;}
      }
    }
  }
  if(Num==0)
  Serial=-1;
  else
  Serial=999; 
  
  for(i=0;i<Num;i++)
  {
    if(element==array[i])
    { Serial=i;break;}    
  }
  
  return Serial;
}

void MaxOrMin(int ArraySize,int Data[],int mod,int& WorstNum)//最差值
{
  int i;
  float wrost;
  
  wrost=Data[0];
  WorstNum=0;
  if(mod==0)//最小值
  {
    WorstNum=0;
    for(i=0;i<ArraySize;i++)
    {
     if(wrost>Data[i])
     {
      wrost=Data[i];
      WorstNum=i;
     }
    }
  }
  else if(mod==1)//最大值
  {
    WorstNum=0;
    for(i=0;i<ArraySize;i++)
    {
     if(wrost<Data[i])
     {
      wrost=Data[i];
      WorstNum=i;
     }
    }
  }
}

void MaxOrMin(int ArraySize,dword Data[],int mod,int& WorstNum)//最差值
{
  int i;
  float wrost;
  
  wrost=Data[0];
  WorstNum=0;
  if(mod==0)//最小值
  {
    WorstNum=0;
    for(i=0;i<ArraySize;i++)
    {
     if(wrost>Data[i])
     {
      wrost=Data[i];
      WorstNum=i;
     }
    }
  }
  else if(mod==1)//最大值
  {
    WorstNum=0;
    for(i=0;i<ArraySize;i++)
    {
     if(wrost<Data[i])
     {
      wrost=Data[i];
      WorstNum=i;
     }
    }
  }
}


qword ANeT_Message_bit_get(qword data,byte StartBit,byte length_data,int Is_Intel)
{
  int i=0,j=0;
  byte out_bit[64];
  byte get_bit[64];
  qword out_k=0;
  qword out_data=0;
  int start_bit;
  
  start_bit=StartBit;
  out_k=data;
  out_data=0;//初始化给初始值不能用
  
  for(i=0;i<64;i++)
  {
    out_bit[i]=0;
    get_bit[i]=0;
  }
  if(Is_Intel==1)
  {
        for(i=0;i<64;i++)
        {
            out_bit[i]=(out_k & 0x01 == 1);
            out_k=out_k>>1;
        }
        for(j=0;j<length_data;j++)
        {
           get_bit[j]=out_bit[start_bit+j];
        }
        for(j=length_data-1;j>=0;j--)
        {
          out_data = out_data<<1;
          out_data = out_data | get_bit[j];
        }
   }
  else
  {
          for(i=0;i<64;i++)
          {
              out_bit[i]=(out_k & 0x01 == 1);
              out_k=out_k>>1;
          }
          for(j=0;j<length_data;j++)
          {
             get_bit[j]=out_bit[start_bit+j];
              if((start_bit+j+1)%8==0)
              {
                start_bit=start_bit-16;
              }
          }
          for(j=length_data-1;j>=0;j--)
          {
            out_data = out_data<<1;
            out_data = out_data | get_bit[j];
          }
  }
  return out_data;
}


void OutMessage(dword ID,int DLC,byte Data[])
{
  message * msg[500];
  int i;
  msg[0].ID = ID;
  msg[0].dlc = DLC;
  for(i=0;i<DLC;i++)
  {
    msg[0].byte(i) = Data[i];
  }
  output(msg[0]);
}

void OutMessage(dword ID,int DLC)
{
  message * msg[500];
  int i;
  msg[0].ID = ID;
  msg[0].dlc = DLC;

  output(msg[0]);
}

void OutMessage(dword ID)
{
  message * msg[500];
  int i;
  msg[0].ID = ID;
  msg[0].dlc = 8;
  for(i=0;i<8;i++)
  {
    msg[0].byte(i) = 0;
  }
  output(msg[0]);
}

void ArrayInital(int array[],int size)

{
  int a;
  a=0;
  do
  {
    array[a]=0;
    a++;
  }while(a<size);
}

void ArrayInital(byte array[],int size)

{
  int a;
  a=0;
  do
  {
    array[a]=0;
    a++;
  }while(a<size);
}

void ArrayInital(dword array[],int size)
{
  int a;
  a=0;
  do
  {
    array[a]=0;
    a++;
  }while(a<size);
}

void ArrayInital(float array[],int size)

{
  int a;
  a=0;
  do
  {
    array[a]=0;
    a++;
    
  }while(a<size);
}


void ANetT_DUTDatabase_ReceiveID(char DUTName1[],dword DataID[],byte DLC[],dword cycletime[],int& Num)//接收的周期型报文提取汇总
{
  int i,j;
  char DUTName[100];
  Num=0;

  substr_cpy(DUTName,DUTName1,0,-1,elcount(DUTName));

 for(i=0;i<T_Clsts[0].T_DUTnumber;i++)
  {
    if(strncmp(DUTName,T_Clsts[0].T_DUT[i].name,100)==0)
    {
      break;
    }
  }
  
 for(j=0;j<T_Clsts[0].T_DUT[i].Rmsgnumber;j++)
  {
    if(T_Clsts[0].T_DUT[i].R_msg[j].ID!=0)// && T_Clsts[0].T_DUT[i].R_msg[j].method==0
    {
      DataID[Num]=T_Clsts[0].T_DUT[i].R_msg[j].ID;
      DLC[Num]=T_Clsts[0].T_DUT[i].R_msg[j].DLC;
      cycletime[Num]=T_Clsts[0].T_DUT[i].R_msg[j].cycletime;
      Num++;
    }
 }
}


void DeleteFile(char path[])
{
   substr_cpy(CL_frame_ID,"007",0,-1,7);
   substr_cpy(CL_frame_FC,"201",0,-1,7);
   substr_cpy(CL_frame_DL,"1",0,-1,7);
   substr_cpy(CL_frame_DATA[0],path,0,-1,5000);

  
   substr_cpy(CL_frame_ACK,"001",0,-1,7);
   CL_frame_build();
   CL_trans_frame();
  
}

void DUTIDAcquire(char path[],int& Num,dword ID[])//0202 DUT当前发送ID
{
   int a=0;
   char string0[10],string1[10],string2[50][10];
  
 
   substr_cpy(CL_frame_ID,"007",0,-1,7);
   substr_cpy(CL_frame_FC,"202",0,-1,7);
   substr_cpy(CL_frame_DL,"1",0,-1,7);
   substr_cpy(CL_frame_DATA[0],path,0,-1,5000);
  
   substr_cpy(CL_frame_ACK,"001",0,-1,7);
   CL_frame_build();
   CL_trans_frame();
  
   substr_cpy(string1,LC_frame_DATA[0],0,-1,5000);
   Num=atol(string1);
   for(a=1;a<=Num;a++)
  { 
    substr_cpy(string2[a-1],LC_frame_DATA[a],0,-1,5000); 
    ID[a-1]=atol(string2[a-1]);
    write("ID[a-1]====%d====%x",(a-1),ID[a-1]);
  }

   putValue(envir_labview_display,"DUTIDAcquire"); 
}

void ANetT_DUTDatabase_ID(char DUTName1[],dword ID[],int& ID_N,dword cycletime[])//数据库信息提取ID信息
{
   int i,j,m=0;
   char DUTName[1000];
  
  
  substr_cpy(DUTName,DUTName1,0,-1,elcount(DUTName));
 for(i=0;i<T_Clsts[0].T_DUTnumber;i++)
  {
    if(strncmp(DUTName,T_Clsts[0].T_DUT[i].name,100)==0)
    {
      break;
    }
  }
    m=0;
 for(j=0;j<T_Clsts[0].T_DUT[i].Tmsgnumber;j++)
  {
    if(T_Clsts[0].T_DUT[i].T_msg[j].method==0)
    {
      cycletime[m]=T_Clsts[0].T_DUT[i].T_msg[j].cycletime;//获取周期
      ID[m]=T_Clsts[0].T_DUT[i].T_msg[j].ID;//获取ID 
      write("cycletime[m]====%d",cycletime[m]);
      write("ID[m]====%x",ID[m]);
      m++;
    }

  }
  ID_N=m;
  
}

void ANetT_DUTDatabase_CycleSearch(char DUTName1[],dword DUTID[],int IDNum,dword cycletime[])
{
   int i,j,m=0;
   char DUTName[1000];
  
   substr_cpy(DUTName,DUTName1,0,-1,elcount(DUTName));
    
   for(i=0;i<T_Clsts[0].T_DUTnumber;i++)
    {
      if(strncmp(DUTName,T_Clsts[0].T_DUT[i].name,100)==0)
      {
        break;
      }
    }
    
    for(m=0;m<IDNum;m++)
    {
      write("DUTID[m]===%d=====%x",m,DUTID[m]);
     for(j=0;j<T_Clsts[0].T_DUT[i].Tmsgnumber;j++)
      {
        if(T_Clsts[0].T_DUT[i].T_msg[j].method==0 && T_Clsts[0].T_DUT[i].T_msg[j].ID==DUTID[m])
        {
          cycletime[m]=T_Clsts[0].T_DUT[i].T_msg[j].cycletime;//获取周期
          write("id====cycle====%x,%d",DUTID[m],cycletime[m]);
        }
      } 
    }
}

void ANetT_DUTDatabase_DLCSearch(char DUTName1[],dword DUTID[],int IDNum,byte DLC[])
{
   int i,j,m=0;
   char DUTName[1000];
  
   substr_cpy(DUTName,DUTName1,0,-1,elcount(DUTName));
  
   for(i=0;i<T_Clsts[0].T_DUTnumber;i++)
    {
      if(strncmp(DUTName,T_Clsts[0].T_DUT[i].name,100)==0)
      {
        break;
      }
    }

    for(m=0;m<IDNum;m++)
    {
      write("DUTID[m]===%d=====%x",m,DUTID[m]);
     for(j=0;j<T_Clsts[0].T_DUT[i].Tmsgnumber;j++)
      {
        if(T_Clsts[0].T_DUT[i].T_msg[j].method==0 && T_Clsts[0].T_DUT[i].T_msg[j].ID==DUTID[m])
        {
          DLC[m]=T_Clsts[0].T_DUT[i].T_msg[j].DLC;//获取DLC
          write("id====DLC====%x,%d",DUTID[m],DLC[m]);
        }
      }      
    }
}