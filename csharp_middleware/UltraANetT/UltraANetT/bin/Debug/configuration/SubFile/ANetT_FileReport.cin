/*@!Encoding:936*/

/*@!Encoding:936*/
void  TestInfoTitle(char title[])
{
  char title1[100];
  
  substr_cpy(title1,title,0,-1,elcount(title1));
  table = TestInfoTable(title1);
  testInfoHeadingBegin(table,0);  
  testInfoCell(table,"测试项目");testInfoCell(table,"测试标准");testInfoCell(table,"测试数值");
  testInfoHeadingEnd(table);
}

void TestInfoData(char Cell0[],char Cell1[],float Cell2)//Cell1标准值Cell2正常值
{
  char s[10];
  snprintf(s,elCount(s),"%.4f",Cell2);
  testInfoRow(table,0);
  testInfoCell(table,Cell0);
  testInfoCell(table,Cell1);
  testInfoCell(table,s);
}

void TestInfoData(char Cell0[],char Cell1[],char Cell2[])//Cell1标准值Cell2正常值
{
  testInfoRow(table,0);
  testInfoCell(table,Cell0);
  testInfoCell(table,Cell1);
  testInfoCell(table,Cell2);
}
