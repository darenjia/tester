/*@!Encoding:936*/
variables
{
  /*---------20191201 BYQ 增加BCM休眠发送报文---------------*/
  message *PowerModeOn_Msg;
  msTimer PowerModeOn_Timer;
  /*---------20191201 BYQ 增加BCM休眠发送报文---------------*/
}
/*----- 测试上电/下电初始化控制 -----*/
void TestInit(int mode)  //测试初始化上电
{
  sysvar::VTS::M1_VT7001.SetInterconnectionMode(1);//VT7001电源模式设置SUP1
//  POW_CurrOutSetup(5);testWaitForTimeout(500);
//  If(DUT.SystemType==1)
//  {
//    POW_VoltOutSetup(24);testWaitForTimeout(500);
//  }
//  else
//  {
//   POW_VoltOutSetup(12);testWaitForTimeout(500);
//  }
  POW_OutputSwitch(1); 
  testWaitForTimeout(100);  //用于等效电源启动过程的等待延时
  
  if(mode==0)
  {
   CASE_TJ_CAN1(0); 
  }
  if(mode==1)
  {
   CASE_TJ_CAN1(1);  
  }
  if (DUT.TerminalR ==1)
  {
   CAN_120_1(1);
  }
  if (DUT.TerminalR ==0)
  {
   CAN_120_1(1);
   CAN_120_2(1);
  }
  KL_on(); 
  Gnd_on();

 }

void TestInit_OnlyKL30(int mode)  //测试初始化上电
{
  sysvar::VTS::M1_VT7001.SetInterconnectionMode(1);//VT7001电源模式设置SUP1
//  POW_CurrOutSetup(5);testWaitForTimeout(500);
//  If(DUT.SystemType==1)
//  {
//    POW_VoltOutSetup(24);testWaitForTimeout(500);
//  }
//  else
//  {
//   POW_VoltOutSetup(12);testWaitForTimeout(500);
//  }
  POW_OutputSwitch(1);
  testWaitForTimeout(100);  //用于等效电源启动过程的等待延时  

  if(mode==0)
  {
   CASE_TJ_CAN1(0); 
  }
  if(mode==1)
  {
   CASE_TJ_CAN1(1);  
  }
  if (DUT.TerminalR ==1)
  {
   CAN_120_1(1);
  }
  if (DUT.TerminalR ==0)
  {
   CAN_120_1(1);
   CAN_120_2(1);
  }
  K30_on();
  Gnd_on();
  
  writetolog("----------测试初始化上电----------");
}

TestEndReset()  //测试结束下电
{
//  POW_OutputSwitch(0);
  KL_off();
  Gnd_off();
  MasterBOBControl(0 , 64, 0, MasteBOB.qword(0));
  write("----------测试结束下电----------");
  writetolog("----------测试结束下电----------");
  testWaitForTimeout(T_KL_OFF+1000);
}

/*----- VT7001控制 -----*/
Gnd_on()
{
  ErrorFlag++;
  MasterBOBControl(6 , 1, ErrorFlag%2, MasteBOB.qword(0));
  Testwaitfortimeout(5);   //继电器动作延时时间
  @sysvar::VTS::M2_Ch3::Relay = 1;
  writetolog("----------上电源地----------");
  //RefValueToSystemVar("上电源地"); 
}

Gnd_off()
{
  ErrorFlag++;
  MasterBOBControl(6 , 1, ErrorFlag%2, MasteBOB.qword(0));
  Testwaitfortimeout(5);   //继电器动作延时时间
  @sysvar::VTS::M2_Ch3::Relay = 0;
  writetolog("----------下电源地----------");
  //RefValueToSystemVar("下电源地"); 
}

K30_on()
{	
  ErrorFlag++;
  MasterBOBControl(6 , 1, ErrorFlag%2, MasteBOB.qword(0));
  Testwaitfortimeout(5);   //继电器动作延时时间
  @sysvar::VTS::M1_Out1::Active = 1;
  writetolog("----------KL30上电----------");
  //RefValueToSystemVar("KL30上电"); 
}

K30_off()
{
  ErrorFlag++;
  MasterBOBControl(6 , 1, ErrorFlag%2, MasteBOB.qword(0));
  Testwaitfortimeout(5);   //继电器动作延时时间
  @sysvar::VTS::M1_Out1::Active = 0;
  writetolog("----------KL30下电----------");
  //RefValueToSystemVar("KL30下电"); 
}

K15_on ()
{  
  ErrorFlag++;
  MasterBOBControl(6 , 1, ErrorFlag%2, MasteBOB.qword(0));
  Testwaitfortimeout(5);   //继电器动作延时时间
  @sysvar::VTS::M1_Out2::Active = 1;
  writetolog("----------KL15上电----------");
  RefValueToSystemVar("KL15上电"); 
  if(strncmp(DUT.Name,"BCM",elCount(DUT.Name))==0)
  {
    writetolog("----------开始发送0x162----------");
    setTimer(PowerModeOn_Timer,20);
  }
}

K15_off ()
{
  ErrorFlag++;
  MasterBOBControl(6 , 1, ErrorFlag%2, MasteBOB.qword(0));
  Testwaitfortimeout(5);   //继电器动作延时时间
  @sysvar::VTS::M1_Out2::Active = 0;
  writetolog("----------KL15下电----------");
  //RefValueToSystemVar("KL15下电");
  if(strncmp(DUT.Name,"BCM",elCount(DUT.Name))==0)
  {
  cancelTimer(PowerModeOn_Timer); 
  writetolog("----------停止发送0x162----------");
  }
}

KL_off()
{
  ErrorFlag++;
  MasterBOBControl(6 , 1, 1, MasteBOB.qword(0));
  //MasterBOBControl(6 , 1, ErrorFlag%2, MasteBOB.qword(0));
  Testwaitfortimeout(5);   //继电器动作延时时间
  @sysvar::VTS::M1_Out1::Active = 0;
  @sysvar::VTS::M1_Out2::Active = 0;
  @sysvar::VTS::M2_Ch1::Relay = 0;
  @sysvar::VTS::M2_Ch2::Relay = 0;
  writetolog("----------KL下电----------");
  //RefValueToSystemVar("KL下电");
}

KL_on()
{
  ErrorFlag++;
  MasterBOBControl(6 , 1, 0, MasteBOB.qword(0));
  //MasterBOBControl(6 , 1, ErrorFlag%2, MasteBOB.qword(0));
  Testwaitfortimeout(5);   //继电器动作延时时间
  write("----------KL上电----------");
  @sysvar::VTS::M1_Out1::Active = 1;
  @sysvar::VTS::M1_Out2::Active = 1;
  @sysvar::VTS::M2_Ch1::Relay = 1;
  @sysvar::VTS::M2_Ch2::Relay = 1;
  writetolog("----------KL上电----------");
  //RefValueToSystemVar("KL上电");
}

Ground_Offset(int State)
{
   CASE_TJ_CAN1(0); 

  if(DUT.TerminalR ==1)
  {
   CAN_120_1(1);
  }
  if (DUT.TerminalR ==0)
  {
   CAN_120_1(1);
   CAN_120_2(1);
  }
  //@sysvar::VTS::M2_Ch1::RelayOpenHigh = 0;
  //@sysvar::VTS::M2_Ch1::RelayOpenLow = 0;     
  if(State==1)
  {
    sysvar::VTS::M1_VT7001.SetInterconnectionMode(9);
    @sysvar::VTS::M1_Sup2::ReversePolarity = 1; //接入H&H电源  
    MasterBOBControl(31 , 1, 1, MasteBOB.qword(0));
    Testwaitfortimeout(5);   //继电器动作延时时间
    POW_Ambi_Initial();
    POW_Ambi_CurrOutSetup(2);
    POW_Ambi_VoltOutSetup(0);
    POW_Ambi_OutputSwitch(1);
    Testwaitfortimeout(50);
    KL_on();
    Gnd_on();    
//    POW_CurrOutSetup(5);testWaitForTimeout(500);
//    If(DUT.SystemType==1)
//    {
//      POW_VoltOutSetup(24);testWaitForTimeout(500);
//    }
//    else
//    {
//     POW_VoltOutSetup(12);testWaitForTimeout(500);
//    }    //必须先配置好地偏移电路，再供电 
    POW_OutputSwitch(1);
    writeToLog("=======开始地偏=======");
    //RefValueToSystemVar("置为地偏移电路"); 
  }
  if(State==0)
  {
    sysvar::VTS::M1_VT7001.SetInterconnectionMode(1);
    @sysvar::VTS::M1_Sup2::ReversePolarity = 0;//断开H&H电源
    MasterBOBControl(31 , 1, 0, MasteBOB.qword(0));
    Testwaitfortimeout(5);   //继电器动作延时时间
    writeToLog("=======地偏恢复=======");
    //RefValueToSystemVar("取消地偏移电路"); 
  }
}

/*----- VT7900控制 -----*/
CANH_off(int State)
{
  if(State==1)
  {
    ErrorFlag++;
    @sysvar::VTS::M2_Ch19::Relay = 0;
    MasterBOBControl(6 , 1, ErrorFlag%2, MasteBOB.qword(0));
    Testwaitfortimeout(5);
    writeToLog("=======CANH断路=======");
    //RefValueToSystemVar("CANH断路"); 
  }
  if(State==0)
  {
    ErrorFlag++;
    @sysvar::VTS::M2_Ch19::Relay = 1;
    MasterBOBControl(6 , 1, ErrorFlag%2, MasteBOB.qword(0));
    //Testwaitfortimeout(300);
    writeToLog("=======CANH断路恢复分析记录文件=======");
    //RefValueToSystemVar("CANH断路恢复"); 
  }
}

CANL_off(int State)
{
  if(State==1)
  {
    ErrorFlag++;
    @sysvar::VTS::M2_Ch20::Relay = 0;
    MasterBOBControl(6 , 1, ErrorFlag%2, MasteBOB.qword(0));
    Testwaitfortimeout(5);
    writeToLog("=======CANL断路=======");
    //RefValueToSystemVar("CANL断路"); 
  }
  if(State==0)
  {
    ErrorFlag++;
    @sysvar::VTS::M2_Ch20::Relay = 1;
    MasterBOBControl(6 , 1, ErrorFlag%2, MasteBOB.qword(0));
    //Testwaitfortimeout(300);
    writeToLog("=======CANL断路恢复分析记录文件=======");
    //RefValueToSystemVar("CANL断路恢复"); 
  }
}

CANHL_off(int State)
{
  if(State==1)
  {
    ErrorFlag++;
    @sysvar::VTS::M2_Ch19::Relay = 0;
    @sysvar::VTS::M2_Ch20::Relay = 0;
    MasterBOBControl(6 , 1, ErrorFlag%2, MasteBOB.qword(0));
    Testwaitfortimeout(5);
    writeToLog("=======CANHL断路=======");
    //RefValueToSystemVar("CANHL断路"); 
  }
  if(State==0)
  {
    ErrorFlag++;
    @sysvar::VTS::M2_Ch19::Relay = 1;
    @sysvar::VTS::M2_Ch20::Relay = 1;
    MasterBOBControl(6 , 1, ErrorFlag%2, MasteBOB.qword(0));
    //Testwaitfortimeout(300);
    writeToLog("=======CANHL断路恢复分析记录文件=======");
    //RefValueToSystemVar("CANHL断路恢复"); 
  }
}

CANH_ShortToPower(int State)
{
  if(State==1)
  {
    ErrorFlag++;
    MasterBOBControl(6 , 1, ErrorFlag%2, MasteBOB.qword(0));
    testWaitForTimeout(2);
    MasterBOBControl(5 , 1, 1, MasteBOB.qword(0));
    MasterBOBControl(0 , 1, 1, MasteBOB.qword(0));
    Testwaitfortimeout(5);
    writeToLog("=======CANH短电=======");
    //RefValueToSystemVar("CANH短电"); 
  }
  if(State==0)
  {
    ErrorFlag++;
    MasterBOBControl(6 , 1, ErrorFlag%2, MasteBOB.qword(0));
    testWaitForTimeout(2);
    MasterBOBControl(5 , 1, 1, MasteBOB.qword(0));
    MasterBOBControl(0 , 1, 0, MasteBOB.qword(0));
    //Testwaitfortimeout(300);
    writeToLog("=======CANH短电恢复分析记录文件=======");
    //RefValueToSystemVar("CANH短电恢复"); 
  }
}

CANL_ShortToPower(int State)
{
  if(State==1)
  {
    ErrorFlag++;
    MasterBOBControl(6 , 1, ErrorFlag%2, MasteBOB.qword(0));
    testWaitForTimeout(2);
    MasterBOBControl(5 , 1, 1, MasteBOB.qword(0));
    MasterBOBControl(8 , 1, 1, MasteBOB.qword(0));
    Testwaitfortimeout(5);
    writeToLog("=======CANL短电=======");
    //RefValueToSystemVar("CANL短电"); 
  }
  if(State==0)
  {
    ErrorFlag++;
    MasterBOBControl(6 , 1, ErrorFlag%2, MasteBOB.qword(0));
    testWaitForTimeout(5);
    MasterBOBControl(5 , 1, 1, MasteBOB.qword(0));
    MasterBOBControl(8 , 1, 0, MasteBOB.qword(0));
    
    //Testwaitfortimeout(300);
    writeToLog("=======CANL短电恢复分析记录文件=======");
    //RefValueToSystemVar("CANL短电恢复"); 
  }
}

CANHL_ShortToPower(int State)
{
  if(State==1)
  {
    ErrorFlag++;
    MasterBOBControl(6 , 1, ErrorFlag%2, MasteBOB.qword(0));
    testWaitForTimeout(2);
    MasterBOBControl(5 , 1, 1, MasteBOB.qword(0));
    MasteBOB.qword(0)=message_bit_set(0, 1, 1, MasteBOB.qword(0));
    MasterBOBControl(8 , 1, 1, MasteBOB.qword(0));
    Testwaitfortimeout(5);
    writeToLog("========CANHL短电======");
    //RefValueToSystemVar("CANHL短电"); 
  }
  if(State==0)
  {
    ErrorFlag++;
    MasterBOBControl(6 , 1, ErrorFlag%2, MasteBOB.qword(0));
    testWaitForTimeout(2);
    MasterBOBControl(5 , 1, 1, MasteBOB.qword(0));
    MasteBOB.qword(0)=message_bit_set(0, 1, 0, MasteBOB.qword(0));
    MasterBOBControl(8 , 1, 0, MasteBOB.qword(0));
    //Testwaitfortimeout(300);
    writeToLog("=======CANHL短电恢复分析记录文件=======");
    //RefValueToSystemVar("CANHL短电恢复"); 
  }
}

CANH_ShortToGnd(int State)
{
  if(State==1)
  {
    ErrorFlag++;
    MasterBOBControl(6 , 1, ErrorFlag%2, MasteBOB.qword(0));
    testWaitForTimeout(2);
    MasterBOBControl(5 , 1, 0, MasteBOB.qword(0));
    MasterBOBControl(7 , 1, 1, MasteBOB.qword(0));
    Testwaitfortimeout(5);
    writeToLog("=======CANH短地=======");
    //RefValueToSystemVar("CANH短地"); 
  }
  if(State==0)
  {
    ErrorFlag++;
    MasterBOBControl(6 , 1, ErrorFlag%2, MasteBOB.qword(0));
    testWaitForTimeout(2);
    MasterBOBControl(5 , 1, 0, MasteBOB.qword(0));
    MasterBOBControl(7 , 1, 0, MasteBOB.qword(0));
    //Testwaitfortimeout(300);
    writeToLog("=======CANH短地恢复分析记录文件=======");
    //RefValueToSystemVar("CANH短地恢复"); 
  }
}

CANL_ShortToGnd(int State)
{
  if(State==1)
  {
    ErrorFlag++;
    MasterBOBControl(6 , 1, ErrorFlag%2, MasteBOB.qword(0));
    testWaitForTimeout(2);
    MasterBOBControl(5 , 1, 0, MasteBOB.qword(0));
    MasterBOBControl(26 , 1, 1, MasteBOB.qword(0));    
    Testwaitfortimeout(5);
    writeToLog("=======CANL短地=======");
    //RefValueToSystemVar("CANL短地"); 
  }
  if(State==0)
  {
    ErrorFlag++;
    MasterBOBControl(6 , 1, ErrorFlag%2, MasteBOB.qword(0));
    testWaitForTimeout(2);
    MasterBOBControl(5 , 1, 0, MasteBOB.qword(0));
    MasterBOBControl(26 , 1, 0, MasteBOB.qword(0));    
    //Testwaitfortimeout(300);
    writeToLog("=======CANL短地恢复分析记录文件=======");
    //RefValueToSystemVar("CANL短地恢复"); 
  }
}

CANHL_ShortToGnd(int State)
{
  if(State==1)
  {
    ErrorFlag++;
    MasterBOBControl(6 , 1, ErrorFlag%2, MasteBOB.qword(0));
    testWaitForTimeout(2);
    MasterBOBControl(5 , 1, 0, MasteBOB.qword(0));
    MasteBOB.qword(0)=message_bit_set(7, 1, 1, MasteBOB.qword(0));
    MasterBOBControl(26 , 1, 1, MasteBOB.qword(0));
    Testwaitfortimeout(5);
    writeToLog("=======CANHL短地=======");
    //RefValueToSystemVar("CANHL短地"); 
  }
  if(State==0)
  {
    ErrorFlag++;
    MasterBOBControl(6 , 1, ErrorFlag%2, MasteBOB.qword(0));
    testWaitForTimeout(2);
    MasterBOBControl(5 , 1, 0, MasteBOB.qword(0));
    MasteBOB.qword(0)=message_bit_set(7, 1, 0, MasteBOB.qword(0));
    MasterBOBControl(26 , 1, 0, MasteBOB.qword(0));    
    //Testwaitfortimeout(300);
    writeToLog("=======CANHL短地恢复分析记录文件=======");
    //RefValueToSystemVar("CANHL短地恢复"); 
  }
}

CANH_ShortTo_CANL(int State)
{
  if(State==1)
  {
    ErrorFlag++;
    MasterBOBControl(6 , 1, ErrorFlag%2, MasteBOB.qword(0));
    testWaitForTimeout(2);
    MasterBOBControl(9 , 1, 1, MasteBOB.qword(0));
    Testwaitfortimeout(5);
    writeToLog("=======CANH对CANL短路=======");
    //RefValueToSystemVar("CANH对CANL短路"); 
  }
  if(State==0)
  {
    ErrorFlag++;
    MasterBOBControl(6 , 1, ErrorFlag%2, MasteBOB.qword(0));
    testWaitForTimeout(2);
    MasterBOBControl(9 , 1, 0, MasteBOB.qword(0));
    //Testwaitfortimeout(300);
    writeToLog("=======CANH对CANL短路恢复分析记录文件=======");
    //RefValueToSystemVar("CANH对CANL短路恢复"); 
  }
}

CAN_WYB(int mode)
{
  if(mode==1)
  {
    TestEndReset();   
    CAN_120_1(0);
    CAN_120_2(0);
    MasteBOB.qword(0)=message_bit_set(3, 1, 1, MasteBOB.qword(0));
    MasterBOBControl(27 , 1, 1, MasteBOB.qword(0));
  }
  
  if(mode==0)
  {
    MasteBOB.qword(0)=message_bit_set(3, 1, 0, MasteBOB.qword(0));
    MasterBOBControl(27 , 1, 0, MasteBOB.qword(0));
  }
  
  @sysvar::VTS::M2_Ch19::Relay = 1;
  @sysvar::VTS::M2_Ch20::Relay = 1;  
}

CASE_TJ_CAN1(int mode)
{
  if(mode==0)//CASE接CAN1
  {
    MasterBOBControl(4 , 1, 1, MasteBOB.qword(0));
    MasterBOBControl(28 , 1, 1, MasteBOB.qword(0));
  }
  
  if(mode==1)//CASE接台架
  {
    MasterBOBControl(4 , 1, 0, MasteBOB.qword(0));
    MasterBOBControl(28 , 1, 0, MasteBOB.qword(0));
  }
    @sysvar::VTS::M2_Ch19::Relay = 1;
    @sysvar::VTS::M2_Ch20::Relay = 1;
}

CAN_120_1(int mode)
{
 if(mode==1)//接120欧终端1
  {
    MasterBOBControl(10 , 2, 3, MasteBOB.qword(0));
  }
 if(mode==0)//不接120欧终端1
  {
    MasterBOBControl(10 , 2, 0, MasteBOB.qword(0));
  }
}

CAN_120_2(int mode)
{
 if(mode==1)//接120欧终端2
  {
    MasterBOBControl(12 , 2, 3, MasteBOB.qword(0));
  }
 if(mode==0)//不接120欧终端2
  {
    MasterBOBControl(12 , 2, 0, MasteBOB.qword(0));
  }
}

DevSelfCheck()
{
  int i=0;
  dword OSC_state=1;
  dword DMM_state=1;
  dword SM70_state=1;
  dword NL_state=1;

  @sysvar::mutualVar::startDeviceSelfCheck=1;     //开始设备自检开始标示符 ->>上位  不能更改
  
/*-----设备自检-----*/   
  /*----OSC  自检---*/
    for(i=0;i<3;i++)
    {
      OSC_Set("192.168.100.1");
      OSC_state=OSC_Initial();
      testWaitForTimeout(2000);
      write("示波器调用次数%d=======%d",i,OSC_state);
      if(OSC_state==0)
        break;
    }
    write("OSC_state=======%d",OSC_state);
    if(OSC_state==0)
    {
      writeProfileString("Devinfo", "Dev0.Name", "示波器", "IncludeFiles\\DevInfo.ini");
      writeProfileString("Devinfo", "Dev0.Model", "MDO4024C", "IncludeFiles\\DevInfo.ini");
      writeProfileString("Devinfo", "Dev0.State", "Normal", "IncludeFiles\\DevInfo.ini");
    }
    else
    {
      writeProfileString("Devinfo", "Dev0.Name", "示波器", "IncludeFiles\\DevInfo.ini");
      writeProfileString("Devinfo", "Dev0.Model", "MDO4024C", "IncludeFiles\\DevInfo.ini");
      writeProfileString("Devinfo", "Dev0.State", "Error", "IncludeFiles\\DevInfo.ini");
    }     
    
  /*----DMM4050  自检---*/
    Dig_Multimeter_Set("com4");//
    for(i=0;i<3;i++)
    {
      Dig_Multimeter_RemoteMode(1);
      DMM_state=Dig_Multimeter_Initial();
      write("数字万用表调用次数%d=======%d",i,DMM_state);
      testWaitForTimeout(2000);
      if(DMM_state==0) break;
    }
    write("DMM_state=======%d",DMM_state);   
    if(DMM_state==0)
    {
      writeProfileString("Devinfo", "Dev1.Name", "数字万用表", "IncludeFiles\\DevInfo.ini");
      writeProfileString("Devinfo", "Dev1.Model", "DMM4050", "IncludeFiles\\DevInfo.ini");
      writeProfileString("Devinfo", "Dev1.State", "Normal", "IncludeFiles\\DevInfo.ini");
    }
    else
    {
      writeProfileString("Devinfo", "Dev1.Name", "数字万用表", "IncludeFiles\\DevInfo.ini");
      writeProfileString("Devinfo", "Dev1.Model", "DMM4050", "IncludeFiles\\DevInfo.ini");
      writeProfileString("Devinfo", "Dev1.State", "Error", "IncludeFiles\\DevInfo.ini");
    }    
    
  /*----SM70-AR-24  自检---*/
    //POW_Set("com1");// 10.1.0.101
    //POW_RemoteModeCV(1);//设置远程模式
    POW_Set("10.1.0.101");// 10.1.0.101
    for(i=0;i<3;i++)
    {
      SM70_state=POW_Initial();
      write("供电电源调用次数%d=======%d",i,SM70_state);
      testWaitForTimeout(2000);
      if(SM70_state==0) break;
    }
    
    write("SM70_state=======%d",SM70_state);
    if(SM70_state==0)
    {
      writeProfileString("Devinfo", "Dev2.Name", "程控电源", "IncludeFiles\\DevInfo.ini");
      writeProfileString("Devinfo", "Dev2.Model", "SM70-AR-24", "IncludeFiles\\DevInfo.ini");
      writeProfileString("Devinfo", "Dev2.State", "Normal", "IncludeFiles\\DevInfo.ini");
    }
    else
    {
      writeProfileString("Devinfo", "Dev2.Name", "程控电源", "IncludeFiles\\DevInfo.ini");
      writeProfileString("Devinfo", "Dev2.Model", "SM70-AR-24", "IncludeFiles\\DevInfo.ini");
      writeProfileString("Devinfo", "Dev2.State", "Error", "IncludeFiles\\DevInfo.ini");
    }       
    
  /*----NL 自检---*/
    POW_Ambi_Set("com5");//com2
    for(i=0;i<3;i++)
    {
      NL_state=POW_Ambi_Initial();
      write("双极性电源调用次数%d====1111===%d",i,NL_state);
     // NL_state=POW_Ambi_CurrOutSetup(2);
      testWaitForTimeout(2000);
      if(NL_state==0) break;
    }
    write("NL_state=======%d",NL_state);
    if(NL_state==0)
    {
      writeProfileString("Devinfo", "Dev3.Name", "双极性电源", "IncludeFiles\\DevInfo.ini");
      writeProfileString("Devinfo", "Dev3.Model", "NL", "IncludeFiles\\DevInfo.ini");
      writeProfileString("Devinfo", "Dev3.State", "Normal", "IncludeFiles\\DevInfo.ini");
    }
    else
    {
      writeProfileString("Devinfo", "Dev3.Name", "双极性电源", "IncludeFiles\\DevInfo.ini");
      writeProfileString("Devinfo", "Dev3.Model", "NL", "IncludeFiles\\DevInfo.ini");
      writeProfileString("Devinfo", "Dev3.State", "Error", "IncludeFiles\\DevInfo.ini");
    }      
    
if((OSC_state==0) && (DMM_state==0) && (SM70_state==0) && (NL_state==0))
  writeProfileString("Devinfo", "FinalResults", "Normal", "IncludeFiles\\DevInfo.ini"); 
else
  writeProfileString("Devinfo", "FinalResults", "Error", "IncludeFiles\\DevInfo.ini"); 

  @sysvar::mutualVar::isEndDeviceSelfCheck=1;  //设备自检结束标示符 ->>上位  不能更改
  write("0000000");

}

qword message_bit_set(sysvarInt * SysName,byte start_bit,int length_data,qword data)
{
    int i,j;
    byte out_bit[64];
    qword out_data;
    qword input_data;
  
  input_data=sysGetVariableInt(SysName);
 //  write("input_data====%x",input_data);  
/*-----原始数据置入数组----*/  
  for(i=0;i<8;i++)
  {
    out_bit[i]=input_data & 0x01;
    input_data=input_data>>1;
  }
/*-----新数据置入数组----*/    
  for(j=0;j<length_data;j++)
  {
    out_bit[start_bit+j]= data & 0x01;
    data=data>>1;
  }
  for(i=63;i>=0;i--)
  {
    out_data = out_data<<1;
    out_data = out_data | out_bit[i];
  }
//  write("out_data====%x",out_data);  
  return out_data;
}

qword message_bit_set(byte start_bit,byte length_data,qword data,qword input_data)
{
  int i=0,j=0;
  byte out_bit[64];
  qword out_k=0;
  qword out_data=0;
  out_k=input_data;
//  write("qword_out_k====%lld",out_k);
  //write("qword_data====%lld",data); 
  for(i=0;i<64;i++)
  {
      out_bit[i]=(out_k & 0x01 == 1);
      out_k=out_k>>1;
  }
  for(j=0;j<length_data;j++)
  {
    out_bit[start_bit+j] = (data & 0x01 == 1);
    data=data>>1;
  }
  for(i=63;i>=0;i--)
  {
    out_data = out_data<<1;
    out_data = out_data | out_bit[i];
  }
//  write("qword_out_data====%lld",out_data);  
  return out_data;

}

MasterBOBControl(byte start_bit,byte length_data,qword data,qword input_data)
{
  MasteBOB.MsgChannel = 2;
  MasteBOB.ID=0x527;
  MasteBOB.DLC=8;
  MasteBOB.qword(0)=message_bit_set(start_bit, length_data, data, input_data);
  output(MasteBOB);
}

void CAN_Cmax(int type)//最大电容负载配置
{  
  if(type==0)                                                        
  {
    MasterBOBControl(17 , 1, 0, MasteBOB.qword(0));
    MasterBOBControl(18 , 1, 0, MasteBOB.qword(0));
    MasterBOBControl(14 , 1, 0, MasteBOB.qword(0));
    MasterBOBControl(15 , 1, 0, MasteBOB.qword(0));    
//    @VT7900::CANH_47nf=0;
//    @VT7900::CANL_47nf=0;
//    @VT7900::CANH_33nf=0;
//    @VT7900::CANL_33nf=0;
  }
  if(type==1)                                                        
  {
    MasterBOBControl(17 , 1, 1, MasteBOB.qword(0));
    MasterBOBControl(18 , 1, 1, MasteBOB.qword(0));
    MasterBOBControl(14 , 1, 1, MasteBOB.qword(0));
    MasterBOBControl(15 , 1, 1, MasteBOB.qword(0));    
  }
  Testwaitfortimeout(2);
}

void CAN_Cmin(int type)//最小电容负载配置
{  
  if(type==0)                                                       
  {
    MasterBOBControl(19 , 1, 0, MasteBOB.qword(0));
    MasterBOBControl(20 , 1, 0, MasteBOB.qword(0));
//    @VT7900::CANH_100pf=0;
//    @VT7900::CANL_100pf=0;
  }
  if(type==1)                                                       
  {
    MasterBOBControl(19 , 1, 1, MasteBOB.qword(0));
    MasterBOBControl(20 , 1, 1, MasteBOB.qword(0));
  }
  Testwaitfortimeout(2);
}




void LINInitial(int mode)//初始化LIN_Initial
{  
  sysvar::VTS::M1_VT7001.SetInterconnectionMode(1);//VT7001电源模式设置SUP1
  KL_on(); 
  Gnd_on(); 
  
  If(DUT.SystemType==1)
  {
  POW_VoltOutSetup(24);testWaitForTimeout(500);
  }
  else
  {
  POW_VoltOutSetup(12);testWaitForTimeout(500);
  }
  POW_OutputSwitch(1); 
  testWaitForTimeout(100);  //用于等效电源启动过程的等待延时
  
 // @sysvar::VTS::M2_Ch4::RelayPin9 = 1;
 // @sysvar::VTS::M2_Ch4::RelayPin4 = 1;
  
  if(mode==0)
  {CASE_TJ_LIN1(0); }
  if(mode==1)
  {CASE_TJ_LIN1(1); }
  
//  POW_CurrOutSetup(5);testWaitForTimeout(500);
}

void LINMasterRtest(int type)//LIN主节点电阻电路
{  
  if(type==0)                                                        
  {
    MasterBOBControl(29 , 1, 0, MasteBOB.qword(0));
   // @VT7900::LIN1_1K=0;
  }
  if(type==1)                                                        
  {
    MasterBOBControl(29 , 1, 1, MasteBOB.qword(0));
  }
}

void LINSlaveRtest(int type)//LIN从节点电阻电路
{  
  if(type==0)                                                        
  {
    MasterBOBControl(30 , 1, 0, MasteBOB.qword(0));
    //@VT7900::LIN1_30K=0;
  }
  if(type==1)                                                        
  {
    MasterBOBControl(30 , 1, 1, MasteBOB.qword(0));
  }
}

LIN_Ground_Offset(int State)
{
   CASE_TJ_LIN1(1); 
  
  //@sysvar::VTS::M2_Ch4::RelayOpenHigh = 0;
  if(State==1)
  {
    sysvar::VTS::M1_VT7001.SetInterconnectionMode(9);
    @sysvar::VTS::M1_Sup2::ReversePolarity = 1; //接入H&H电源  
    MasterBOBControl(31 , 1, 1, MasteBOB.qword(0));
    Testwaitfortimeout(5);   //继电器动作延时时间
    POW_Ambi_Initial();
    POW_Ambi_CurrOutSetup(2);
    POW_Ambi_VoltOutSetup(0);
    POW_Ambi_OutputSwitch(1);
    Testwaitfortimeout(50);
    KL_on();
    Gnd_on();   
//    @sysvar::VTS::M2_Ch4::RelayPin9 = 1;
//    @sysvar::VTS::M2_Ch4::RelayPin4 = 1;
    POW_CurrOutSetup(5);
    POW_OutputSwitch(1);
    testWaitForTimeout(500);   
    POW_VoltOutSetup(12);    //必须先配置好地偏移电路，再供电  
    write("=======开始地偏=======");
    writeToLog("=======开始地偏=======");
    //RefValueToSystemVar("置为地偏移电路"); 
  }
  if(State==0)
  {
    sysvar::VTS::M1_VT7001.SetInterconnectionMode(1);
    @sysvar::VTS::M1_Sup2::ReversePolarity = 0;//断开H&H电源
    MasterBOBControl(31 , 1, 0, MasteBOB.qword(0));
    Testwaitfortimeout(5);   //继电器动作延时时间
    writeToLog("=======地偏恢复=======");
    //RefValueToSystemVar("取消地偏移电路"); 
  }
}

void CASE_TJ_LIN1(int mode)
{
  if(mode==0)                                                        //只接示波器
  {
    //MasterBOBControl(4 , 1, 1, MasteBOB.qword(0));
    MasterBOBControl(25 , 1, 0, MasteBOB.qword(0));
  }
  if(mode==1)                                                        //接示波器和Case
  {
    //MasterBOBControl(4 , 1, 0, MasteBOB.qword(0));
    MasterBOBControl(25 , 1, 1, MasteBOB.qword(0));
  }
  
  @sysvar::VTS::M2_Ch19::Relay = 1;

}


LIN_off(int State)
{
  if(State==1)
  {
    ErrorFlag++;
    @sysvar::VTS::M2_Ch19::Relay = 0;
    MasterBOBControl(6 , 1, ErrorFlag%2, MasteBOB.qword(0));
    Testwaitfortimeout(5);
    writeToLog("=======LIN断路=======");
    //RefValueToSystemVar("LIN断路"); 
  }
  if(State==0)
  {
    ErrorFlag++;
    @sysvar::VTS::M2_Ch19::Relay = 1;
    MasterBOBControl(6 , 1, ErrorFlag%2, MasteBOB.qword(0));
    //Testwaitfortimeout(300);
    writeToLog("=======LIN断路恢复分析记录文件=======");
    //RefValueToSystemVar("LIN断路恢复"); 
  }
}

LIN_ShortToPower(int State)
{
  if(State==1)
  {
    ErrorFlag++;
    MasterBOBControl(6 , 1, ErrorFlag%2, MasteBOB.qword(0));
    testWaitForTimeout(2);
    MasterBOBControl(5 , 1, 1, MasteBOB.qword(0));
    MasterBOBControl(0 , 1, 1, MasteBOB.qword(0));
    Testwaitfortimeout(5);
    writeToLog("=======LIN短电=======");
    //RefValueToSystemVar("LIN短电"); 
  }
  if(State==0)
  {
    ErrorFlag++;
    MasterBOBControl(6 , 1, ErrorFlag%2, MasteBOB.qword(0));
    testWaitForTimeout(2);
    MasterBOBControl(5 , 1, 1, MasteBOB.qword(0));
    MasterBOBControl(0 , 1, 0, MasteBOB.qword(0));
    //Testwaitfortimeout(300);
    writeToLog("=======LINH短电恢复分析记录文件=======");
    //RefValueToSystemVar("LIN短电恢复"); 
  }
}

LIN_ShortToGnd(int State)
{
  if(State==1)
  {
    ErrorFlag++;
    MasterBOBControl(6 , 1, ErrorFlag%2, MasteBOB.qword(0));
    testWaitForTimeout(2);
    MasterBOBControl(5 , 1, 0, MasteBOB.qword(0));
    MasterBOBControl(7 , 1, 1, MasteBOB.qword(0));
    Testwaitfortimeout(5);
    writeToLog("=======LIN短地=======");
    //RefValueToSystemVar("LIN短地"); 
  }
  if(State==0)
  {
    ErrorFlag++;
    MasterBOBControl(6 , 1, ErrorFlag%2, MasteBOB.qword(0));
    testWaitForTimeout(2);
    MasterBOBControl(5 , 1, 0, MasteBOB.qword(0));
    MasterBOBControl(7 , 1, 0, MasteBOB.qword(0));
    //Testwaitfortimeout(300);
    writeToLog("=======LIN短地恢复分析记录文件=======");
    //RefValueToSystemVar("LIN短地恢复"); 
  }
}



