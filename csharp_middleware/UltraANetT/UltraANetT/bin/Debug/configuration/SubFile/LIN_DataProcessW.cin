/*@!Encoding:936*/
long ANetT_Database_LIN_File(char Path[])
{
  char Sbuf[1000];
  char Dbuf[1000];
  long Re=0;
  char absPath[1000];
  getAbsFilePath(Path,absPath,1000);
  strncpy(Sbuf,"",elCount(Sbuf));
  strncat(Sbuf,"ANetT_Database_LIN_File@",elCount(Sbuf));
  strncat(Sbuf,absPath,elCount(Sbuf));
  strncat(Sbuf,"@",elCount(Sbuf));
  putValue(CAPL_String,Sbuf);
  testWaitForTimeout(1);
  putValue(CAPL_TIME,timeNow());
  write("CAPL_TIME====%f",getValue(CAPL_TIME));
  while(1)
  {
    if(getValue(StateMachine_TIME)!=State_TIME_)
    {
      getValue(StateMachine_String,State_String_);
      write("State_String_===%s",State_String_);
      break;
    }
    testWaitForTimeout(1);
  }
  k1=strstr_off(State_String_,0,"@");
  if(k1>0)
  {
    substr_cpy(Dbuf,State_String_,0,k1,elCount(Dbuf));
    Re=atol(Dbuf);
    write("Re===%d",Re);
  }
  else Re=-1;
  State_TIME_=getValue(StateMachine_TIME);
  return Re;
}

long ANetT_Database_LINID(char DUTName[], dword ID[] , long DLC[])
{
  char Sbuf[1000];
  char Dbuf1[1000];
  char Dbuf2[1000];
  char Dbuf3[1000];
  char IDTemp[10];
  char DLCTemp[10];
  long Re=0;
  int i=0;
  int j=0;
  strncpy(Sbuf,"",elCount(Sbuf));
  strncat(Sbuf,"ANetT_Database_LINID@",elCount(Sbuf));
  strncat(Sbuf,DUTName,elCount(Sbuf));
  strncat(Sbuf,"@",elCount(Sbuf));
  putValue(CAPL_String,Sbuf);
  testWaitForTimeout(1);
  putValue(CAPL_TIME,timeNow());
  while(1)
  {
    if(getValue(StateMachine_TIME)!=State_TIME_)
    {
      getValue(StateMachine_String,State_String_);
      break;
    }
    testWaitForTimeout(100);
  }
  k1=strstr_off(State_String_,0,"@");
  k2=strstr_off(State_String_,k1+1,"@");
  k3=strstr_off(State_String_,k2+1,"@");
  if(k1>0&&k2>0&&k3>0)
  {
    substr_cpy(Dbuf1,State_String_,0,k1,elCount(Dbuf1));
    substr_cpy(Dbuf2,State_String_,k1+1,k2-k1-1,elCount(Dbuf2));
    substr_cpy(Dbuf3,State_String_,k2+1,k3-k2-1,elCount(Dbuf3));
    Re=atol(Dbuf1);
    k4=-1;
    write("ID====%s",Dbuf2);
    write("DLC====%s",Dbuf3);
    for(i=0;i<500;i++)
    {
      if(strstr_off(Dbuf2,k4+1,"#")<=0) break;
      for(j=0;j<10;j++)
      {
        IDTemp[j]=0;
      }
      substr_cpy(IDTemp,Dbuf2,k4+1,strstr_off(Dbuf2,k4+1,"#")-k4-1,elCount(IDTemp));
      strtoul(IDTemp,ID[i]);
      k4=strstr_off(Dbuf2,k4+1,"#");
    }
    k5=-1;
    for(i=0;i<500;i++)
    {
      if(strstr_off(Dbuf3,k5+1,"#")<=0) break;
      for(j=0;j<10;j++)
      {
        DLCTemp[j]=0;
      }
      substr_cpy(DLCTemp,Dbuf3,k5+1,strstr_off(Dbuf3,k5+1,"#")-k5-1,elCount(DLCTemp));
      strtol(DLCTemp,DLC[i]);
      k5=strstr_off(Dbuf3,k5+1,"#");
    }
   }
  else Re=-1;
  State_TIME_=getValue(StateMachine_TIME);
  return Re;
}

long ANetT_Database_LINSignal(char DUTName[], dword ID[],long signal_N[],long startbit[][],long length[][])
{
  char Sbuf[1000];
  char Dbuf1[2000];
  char Dbuf2[2000];
  char Dbuf3[2000];
  char Dbuf4[2000];
  char Dbuf5[2000];
  char IDTemp[10];
  char signal_NTemp[10];
  char startbitTemp1[500];
  char startbitTemp2[10];
  char lengthTemp1[500];
  char lengthTemp2[10];
  long Re=0;
  int i=0;
  int j=0;
  int k=0;
  strncpy(Sbuf,"",elCount(Sbuf));
  strncat(Sbuf,"ANetT_Database_LINSignal@",elCount(Sbuf));
  strncat(Sbuf,DUTName,elCount(Sbuf));
  strncat(Sbuf,"@",elCount(Sbuf));
  putValue(CAPL_String,Sbuf);
  testWaitForTimeout(1);
  putValue(CAPL_TIME,timeNow());
  while(1)
  {
    if(getValue(StateMachine_TIME)!=State_TIME_)
    {
      getValue(StateMachine_String,State_String_);
      break;
    }
    testWaitForTimeout(1);
  }
  k1=strstr_off(State_String_,0,"@");//个数
  k2=strstr_off(State_String_,k1+1,"@");//ID
  k3=strstr_off(State_String_,k2+1,"@");//信号个数
  k4=strstr_off(State_String_,k3+1,"@");//STB
  k5=strstr_off(State_String_,k4+1,"@");//length
  if(k1>0&&k2>0&&k3>0&&k4>0&&k5>0)
  {
    substr_cpy(Dbuf1,State_String_,0,k1,elCount(Dbuf1));
    substr_cpy(Dbuf2,State_String_,k1+1,k2-k1-1,elCount(Dbuf2));
    substr_cpy(Dbuf3,State_String_,k2+1,k3-k2-1,elCount(Dbuf3));
    substr_cpy(Dbuf4,State_String_,k3+1,k4-k3-1,elCount(Dbuf4));
    substr_cpy(Dbuf5,State_String_,k4+1,k5-k4-1,elCount(Dbuf5));
    Re=atol(Dbuf1);
    k7=-1;
    write("ID====%s",Dbuf2);
    write("信号个数====%s",Dbuf3);
    write("STB====%s",Dbuf4);
    write("length====%s",Dbuf5);
    for(i=0;i<500;i++)
    {
      if(strstr_off(Dbuf2,k7+1,"#")<=0) break;
      for(j=0;j<10;j++)
      {
        IDTemp[j]=0;
      }
      substr_cpy(IDTemp,Dbuf2,k7+1,strstr_off(Dbuf2,k7+1,"#")-k7-1,elCount(IDTemp));
      strtoul(IDTemp,ID[i]);
      k7=strstr_off(Dbuf2,k7+1,"#");
    }
    k8=-1;
    for(i=0;i<500;i++)
    {
      if(strstr_off(Dbuf3,k8+1,"#")<=0) break;
      for(j=0;j<10;j++)
      {
        signal_NTemp[j]=0;
      }
      substr_cpy(signal_NTemp,Dbuf3,k8+1,strstr_off(Dbuf3,k8+1,"#")-k8-1,elCount(signal_NTemp));
      strtol(signal_NTemp,signal_N[i]);
      k8=strstr_off(Dbuf3,k8+1,"#");
    }
    k9=-1;
    for(i=0;i<Re;i++)
    {
      if(strstr_off(Dbuf4,k9+1,"#")<=0) break;
      for(j=0;j<signal_N[i];j++)
      {
        startbitTemp1[j]=0;
      
      substr_cpy(startbitTemp1,Dbuf4,k9+1,strstr_off(Dbuf4,k9+1,"#")-k9-1,elCount(startbitTemp1));
    
      strtol(startbitTemp1,startbit[i][j]);
      k9=strstr_off(Dbuf4,k9+1,"#");
      }
    }
    
    k10=-1;
    for(i=0;i<500;i++)
    {      
      if(strstr_off(Dbuf5,k10+1,"#")<=0) break;
      for(j=0;j<signal_N[i];j++)
      {
        lengthTemp1[j]=0;      
      substr_cpy(lengthTemp1,Dbuf5,k10+1,strstr_off(Dbuf5,k10+1,"#")-k10-1,elCount(lengthTemp1));
      strtol(lengthTemp1,length[i][j]);   
      k10=strstr_off(Dbuf5,k10+1,"#");
      }
    }

  }
  else Re=-1;
  State_TIME_=getValue(StateMachine_TIME);
  return Re;
}

long ANetT_Database_LINResponseError(char DUTName[], dword ID[],long startbit[])
{
  char Sbuf[1000];
  char Dbuf1[2000];
  char Dbuf2[2000];
  char Dbuf3[2000];
  char Dbuf4[2000];
  char Dbuf5[2000];
  char IDTemp[10];
  char startbitTemp1[500];
  long Re=0;
  int i=0;
  int j=0;
  int k=0;
  strncpy(Sbuf,"",elCount(Sbuf));
  strncat(Sbuf,"ANetT_Database_LINResponseError@",elCount(Sbuf));
  strncat(Sbuf,DUTName,elCount(Sbuf));
  strncat(Sbuf,"@",elCount(Sbuf));
  putValue(CAPL_String,Sbuf);
  testWaitForTimeout(1);
  putValue(CAPL_TIME,timeNow());
  while(1)
  {
    if(getValue(StateMachine_TIME)!=State_TIME_)
    {
      getValue(StateMachine_String,State_String_);
      break;
    }
    testWaitForTimeout(100);
  }
  k1=strstr_off(State_String_,0,"@");
  k2=strstr_off(State_String_,k1+1,"@");
  k3=strstr_off(State_String_,k2+1,"@");
  if(k1>0&&k2>0&&k3>0)
  {
    substr_cpy(Dbuf1,State_String_,0,k1,elCount(Dbuf1));
    substr_cpy(Dbuf2,State_String_,k1+1,k2-k1-1,elCount(Dbuf2));
    substr_cpy(Dbuf3,State_String_,k2+1,k3-k2-1,elCount(Dbuf3));
    Re=atol(Dbuf1);
    k4=-1;
    write("获取ResponseError的ID====%s",Dbuf2);
    write("ResponseError的起始位====%s",Dbuf3);
    for(i=0;i<500;i++)
    {
      if(strstr_off(Dbuf2,k4+1,"#")<=0) break;
      for(j=0;j<10;j++)
      {
        IDTemp[j]=0;
      }
      substr_cpy(IDTemp,Dbuf2,k4+1,strstr_off(Dbuf2,k4+1,"#")-k4-1,elCount(IDTemp));
      strtoul(IDTemp,ID[i]);
      k4=strstr_off(Dbuf2,k4+1,"#");
    }
    k5=-1;
    for(i=0;i<500;i++)
    {
      if(strstr_off(Dbuf3,k5+1,"#")<=0) break;
      for(j=0;j<10;j++)
      {
        startbitTemp1[j]=0;
      }
      substr_cpy(startbitTemp1,Dbuf3,k5+1,strstr_off(Dbuf3,k5+1,"#")-k5-1,elCount(startbitTemp1));
      strtol(startbitTemp1,startbit[i]);
      k5=strstr_off(Dbuf3,k5+1,"#");
    }
  }
  else Re=-1;
  State_TIME_=getValue(StateMachine_TIME);
  return Re;
}

long ANetT_Database_LINSchedule(dword ST_ID[],long STDelay[],long DLC[])
{
  char Sbuf[1000];
  char Dbuf1[1000];
  char Dbuf2[1000];
  char Dbuf3[1000];
  char Dbuf4[1000];
  char IDTemp[100];
  char IDDelayTemp[100];
  char DLCTemp[1000];
  long Re=0;
  int i=0;
  int j=0;
  strncpy(Sbuf,"",elCount(Sbuf));
  strncat(Sbuf,"ANetT_Database_LINSchedule@",elCount(Sbuf));
  putValue(CAPL_String,Sbuf);
  testWaitForTimeout(1);
  putValue(CAPL_TIME,timeNow());
  while(1)
  {
    if(getValue(StateMachine_TIME)!=State_TIME_)
    {
      getValue(StateMachine_String,State_String_);
      break;
    }
    testWaitForTimeout(1);
  }
  k1=strstr_off(State_String_,0,"@");
  k2=strstr_off(State_String_,k1+1,"@");
  k3=strstr_off(State_String_,k2+1,"@");
  k4=strstr_off(State_String_,k3+1,"@");
  if(k1>0&&k2>0&&k3>0&&k4>0)
  {
    substr_cpy(Dbuf1,State_String_,0,k1,elCount(Dbuf1));
    substr_cpy(Dbuf2,State_String_,k1+1,k2-k1-1,elCount(Dbuf2));
    substr_cpy(Dbuf3,State_String_,k2+1,k3-k2-1,elCount(Dbuf3));
    substr_cpy(Dbuf4,State_String_,k3+1,k4-k3-1,elCount(Dbuf4));
    write("调度表个数==:%s",Dbuf1);
    write("ST_ID==:%s",Dbuf2);
    write("STDelay==:%s",Dbuf3);
    write("DLC==:%s",Dbuf4);
    Re=atol(Dbuf1);
    k5=-1;
    for(i=0;i<500;i++)
    {
      if(strstr_off(Dbuf2,k5+1,"#")<=0) break;
      for(j=0;j<10;j++)
      {
        IDTemp[j]=0;
      }
      substr_cpy(IDTemp,Dbuf2,k5+1,strstr_off(Dbuf2,k5+1,"#")-k5-1,elCount(IDTemp));
      strtoul(IDTemp,ST_ID[i]);
      k5=strstr_off(Dbuf2,k5+1,"#");
    }
        k6=-1;
    for(i=0;i<500;i++)
    {
      if(strstr_off(Dbuf3,k6+1,"#")<=0) break;
      for(j=0;j<10;j++)
      {
        IDDelayTemp[j]=0;
      }
      substr_cpy(IDDelayTemp,Dbuf3,k6+1,strstr_off(Dbuf3,k6+1,"#")-k6-1,elCount(IDDelayTemp));
      strtol(IDDelayTemp,STDelay[i]);
      k6=strstr_off(Dbuf3,k6+1,"#");
    }
    k7=-1;
    for(i=0;i<500;i++)
    {
      if(strstr_off(Dbuf4,k7+1,"#")<=0) break;
      for(j=0;j<10;j++)
      {
        DLCTemp[j]=0;
      }
      substr_cpy(DLCTemp,Dbuf4,k7+1,strstr_off(Dbuf4,k7+1,"#")-k7-1,elCount(DLCTemp));
      strtol(DLCTemp,DLC[i]);
      k7=strstr_off(Dbuf4,k7+1,"#");
    }  
  }
  else Re=-1;
  State_TIME_=getValue(StateMachine_TIME);
  return Re;
}

long ANetT_Test_LINDLC(char Path[],dword StandardID[],long StandardDLC[],char Describ[])
{
  char Sbuf[1000];
  char Dbuf1[1000];
  char Dbuf2[1000];
  char Dbuf3[1000];
  char ChannelTemp[10];
  char StandardIDTemp[10];
  char StandardDLCTemp[10];
  long Re=0;
  int i=0;
  int j=0;
  char absPath[1000];
  getAbsFilePath(Path,absPath,1000);
  strncpy(Sbuf,"",elCount(Sbuf));
  strncat(Sbuf,"ANetT_Test_LINDLC@",elCount(Sbuf));
  strncat(Sbuf,absPath,elCount(Sbuf));
  strncat(Sbuf,"@",elCount(Sbuf));
  for(i=0;i<500;i++)
  {
    if(StandardID[i]=='\0') break;
    ltoa(StandardID[i],StandardIDTemp,16);
    strncat(Sbuf,StandardIDTemp,elCount(Sbuf));
    strncat(Sbuf,"#",elCount(Sbuf));
  }
  strncat(Sbuf,"@",elCount(Sbuf));
  for(j=0;j<500;j++)
  {
    if(StandardDLC[j]=='\0') break;
    ltoa(StandardDLC[j],StandardDLCTemp,10);
    strncat(Sbuf,StandardDLCTemp,elCount(Sbuf));
    strncat(Sbuf,"#",elCount(Sbuf));
  }
  strncat(Sbuf,"@",elCount(Sbuf));
  write("Sbuf======LINDLC========%s",Sbuf);
  putValue(CAPL_String,Sbuf);  
  testWaitForTimeout(1);
  putValue(CAPL_TIME,timeNow());
  while(1)
  {
    if(getValue(StateMachine_TIME)!=State_TIME_)
    {
      getValue(StateMachine_String,State_String_);
      break;
    }
    testWaitForTimeout(1);
  }
  k1=strstr_off(State_String_,0,"@");
  k2=strstr_off(State_String_,k1+1,"@");
  if(k1>0&&k2>0)
  {
    substr_cpy(Dbuf1,State_String_,0,k1,elCount(Dbuf1));
    substr_cpy(Dbuf2,State_String_,k1+1,k2-k1-1,elCount(Dbuf2));
    write("Describ==Test_LINDLC==:%s",Dbuf2);
    Re=atol(Dbuf1);
    strncpy (Describ,Dbuf2,elcount(Describ));
  }
  else Re=-1;
  State_TIME_=getValue(StateMachine_TIME);
  return Re;
}

long ANetT_Test_LINScheduleSeq(char Path[],dword ST_ID[],char Describ[])
{
  char Sbuf[1000];
  char Dbuf1[1000];
  char Dbuf2[1000];
  char Dbuf3[1000];
  char ST_IDTemp[10];
  long Re=0;
  int i=0;
  int j=0;
  char absPath[1000];
  getAbsFilePath(Path,absPath,1000);
  strncpy(Sbuf,"",elCount(Sbuf));
  strncat(Sbuf,"ANetT_Test_LINScheduleSeq@",elCount(Sbuf));
  strncat(Sbuf,absPath,elCount(Sbuf));
  strncat(Sbuf,"@",elCount(Sbuf));
  for(i=0;i<500;i++)
  {
    if(ST_ID[i]=='\0') break;
    ltoa(ST_ID[i],ST_IDTemp,16);
    strncat(Sbuf,ST_IDTemp,elCount(Sbuf));
    strncat(Sbuf,"#",elCount(Sbuf));
  }
  strncat(Sbuf,"@",elCount(Sbuf));
  putValue(CAPL_String,Sbuf);
  testWaitForTimeout(1);
  putValue(CAPL_TIME,timeNow());
  while(1)
  {
    if(getValue(StateMachine_TIME)!=State_TIME_)
    {
      getValue(StateMachine_String,State_String_);
      break;
    }
    testWaitForTimeout(1);
  }
  k1=strstr_off(State_String_,0,"@");
  k2=strstr_off(State_String_,k1+1,"@");
  if(k1>0&&k2>0)
  {
    substr_cpy(Dbuf1,State_String_,0,k1,elCount(Dbuf1));
    substr_cpy(Dbuf2,State_String_,k1+1,k2-k1-1,elCount(Dbuf2));
    //write("Describ==LINScheduleSeq==:%s",Dbuf2);
    Re=atol(Dbuf1);
    strncpy (Describ,Dbuf2,elcount(Describ));
  }
  else Re=-1;
  State_TIME_=getValue(StateMachine_TIME);
  return Re;
}

long ANetT_Test_LINScheduleSeqTime(char Path[],dword ST_ID[],long STDelay[] ,char Describ[])
{
  char Sbuf[1000];
  char Dbuf1[1000];
  char Dbuf2[1000];
  char Dbuf3[1000];
  char ST_IDTemp[10];
  char STDelayTemp[10];
  long Re=0;
  int i=0;
  int j=0;
  char absPath[1000];
  getAbsFilePath(Path,absPath,1000);
  strncpy(Sbuf,"",elCount(Sbuf));
  strncat(Sbuf,"ANetT_Test_LINScheduleSeqTime@",elCount(Sbuf));
  strncat(Sbuf,absPath,elCount(Sbuf));
  strncat(Sbuf,"@",elCount(Sbuf));
  for(i=0;i<500;i++)
  {
    if(ST_ID[i]=='\0') break;
    ltoa(ST_ID[i],ST_IDTemp,16);
    strncat(Sbuf,ST_IDTemp,elCount(Sbuf));
    strncat(Sbuf,"#",elCount(Sbuf));
  }
  strncat(Sbuf,"@",elCount(Sbuf));
  for(j=0;j<500;j++)
  {
    if(STDelay[j]=='\0') break;
    ltoa(STDelay[j],STDelayTemp,10);
    strncat(Sbuf,STDelayTemp,elCount(Sbuf));
    strncat(Sbuf,"#",elCount(Sbuf));
  }
  strncat(Sbuf,"@",elCount(Sbuf));
  write("Sbuf====:%s",Sbuf);
  putValue(CAPL_String,Sbuf);
  testWaitForTimeout(1);
  putValue(CAPL_TIME,timeNow());
  while(1)
  {
    if(getValue(StateMachine_TIME)!=State_TIME_)
    {
      getValue(StateMachine_String,State_String_);
      break;
    }
    testWaitForTimeout(1);
  }
  k1=strstr_off(State_String_,0,"@");
  k2=strstr_off(State_String_,k1+1,"@");
  
  if(k1>0&&k2>0)
  {
    // write("Sbuf====:%s",State_String_);
    substr_cpy(Dbuf1,State_String_,0,k1,elCount(Dbuf1));
   // write("Dbuf1====:%s",Dbuf1);
    substr_cpy(Dbuf2,State_String_,k1+1,k2-k1-1,elCount(Dbuf2));
  //  write("Dbuf2====:%s",Dbuf2);
    write("Re====LINScheduleSeqTime=====:%s",Dbuf1);
    write("Describ====LINScheduleSeqTime=====:%s",Dbuf2);
    Re=atol(Dbuf1);
    strncpy (Describ,Dbuf2,elcount(Describ));
  }
  else Re=-1;
  State_TIME_=getValue(StateMachine_TIME);
  return Re;
}

long ANetT_Test_LIN_StuffBit(char Path[],dword StandardID[],long signal_N[],long startbit[][],long length[][],char Describ[])
{
  char Sbuf[1000];
  char Dbuf1[1000];
  char Dbuf2[1000];
  char Dbuf3[1000];
  char StandardIDTemp[100];
  char signal_NTemp[100];
  char startbitTemp[100];
  char lengthTemp[100];
  long Re=0;
  int i=0;
  int j=0;
  int p=0;
  int m=0;
  int n=0;
  int q=0;  
  char absPath[1000];
  getAbsFilePath(Path,absPath,1000);
  strncpy(Sbuf,"",elCount(Sbuf));
  strncat(Sbuf,"ANetT_Test_LIN_StuffBit@",elCount(Sbuf));
  strncat(Sbuf,absPath,elCount(Sbuf));
  strncat(Sbuf,"@",elCount(Sbuf));
  for(i=0;i<500;i++)
  {
    if(StandardID[i]=='\0') break;
    ltoa(StandardID[i],StandardIDTemp,16);
    strncat(Sbuf,StandardIDTemp,elCount(Sbuf));
    strncat(Sbuf,"#",elCount(Sbuf));
  }
  strncat(Sbuf,"@",elCount(Sbuf));
  for(j=0;j<500;j++)
  {
    if(signal_N[j]=='\0') break;
    ltoa(signal_N[j],signal_NTemp,10);
    strncat(Sbuf,signal_NTemp,elCount(Sbuf));
    strncat(Sbuf,"#",elCount(Sbuf));
  }
  strncat(Sbuf,"@",elCount(Sbuf));
  for(m=0;m<50;m++)
  {
    if(signal_N[m]=='\0') break;
    for(n=0;n<signal_N[m];n++)
    {
      ltoa(startbit[m][n],startbitTemp,10);
      strncat(Sbuf,startbitTemp,elCount(Sbuf));
      strncat(Sbuf,"#",elCount(Sbuf));
      //if(startbit[m][n+1]=='\0') break;
    }
  }
  strncat(Sbuf,"@",elCount(Sbuf));
  for(p=0;p<50;p++)
  {
    for(q=0;q<100;q++)
    {
      if(length[p][q]=='\0') break;
      ltoa(length[p][q],lengthTemp,10);
      strncat(Sbuf,lengthTemp,elCount(Sbuf));
      strncat(Sbuf,"#",elCount(Sbuf));
    }
  }
  write ("44444444444444444444444444444444444444444");
  strncat(Sbuf,"@",elCount(Sbuf));
  write("Sbuf==Test_LIN_StuffBit==%s",Sbuf);
  putValue(CAPL_String,Sbuf);
  testWaitForTimeout(1);
  putValue(CAPL_TIME,timeNow());
  while(1)
  {
    if(getValue(StateMachine_TIME)!=State_TIME_)
    {
      getValue(StateMachine_String,State_String_);
      break;
    }
    testWaitForTimeout(1);
  }
  k1=strstr_off(State_String_,0,"@");
  k2=strstr_off(State_String_,k1+1,"@");
  if(k1>0&&k2>0)
  {
    substr_cpy(Dbuf1,State_String_,0,k1,elCount(Dbuf1));
    substr_cpy(Dbuf2,State_String_,k1+1,k2-k1-1,elCount(Dbuf2));
    write("结果==Test_LIN_StuffBit检测==%s",Dbuf2);
    Re=atol(Dbuf1);
    strncpy (Describ,Dbuf2,elcount(Describ));
  }
  else Re=-1;
  State_TIME_=getValue(StateMachine_TIME);
  return Re;
}

long ANetT_Test_LINResponseError(char Path[],dword StandardID[],long startbit[],char Describ[])
{
  char Sbuf[1000];
  char Dbuf1[1000];
  char Dbuf2[1000];
  char Dbuf3[1000];
  char StandardIDTemp[10];
  char startbitTemp[10];
  long Re=0;
  int i=0;
  int j=0;
  char absPath[1000];
  getAbsFilePath(Path,absPath,1000);
  strncpy(Sbuf,"",elCount(Sbuf));
  strncat(Sbuf,"ANetT_Test_LINResponseError@",elCount(Sbuf));
  strncat(Sbuf,absPath,elCount(Sbuf));
  strncat(Sbuf,"@",elCount(Sbuf));
  for(i=0;i<500;i++)
  {
    if(StandardID[i]=='\0') break;
    ltoa(StandardID[i],StandardIDTemp,16);
    strncat(Sbuf,StandardIDTemp,elCount(Sbuf));
    strncat(Sbuf,"#",elCount(Sbuf));
  }
  strncat(Sbuf,"@",elCount(Sbuf));
  for(j=0;j<500;j++)
  {
    if(startbit[j]=='\0') break;
    ltoa(startbit[j],startbitTemp,10);
    strncat(Sbuf,startbitTemp,elCount(Sbuf));
    strncat(Sbuf,"#",elCount(Sbuf));
  }
  strncat(Sbuf,"@",elCount(Sbuf));
  write("Sbuf====:%s",Sbuf);
  putValue(CAPL_String,Sbuf);  
  testWaitForTimeout(1);
  putValue(CAPL_TIME,timeNow());
  while(1)
  {
    if(getValue(StateMachine_TIME)!=State_TIME_)
    {
       
      getValue(StateMachine_String,State_String_);
      break;
    }
    testWaitForTimeout(1);
  }
  k1=strstr_off(State_String_,0,"@");
  k2=strstr_off(State_String_,k1+1,"@");
  if(k1>0&&k2>0)
  {
    substr_cpy(Dbuf1,State_String_,0,k1,elCount(Dbuf1));
    substr_cpy(Dbuf2,State_String_,k1+1,k2-k1-1,elCount(Dbuf2));
    write("结果==LINResponseError检测==%s",Dbuf2);
    Re=atol(Dbuf1);
    strncpy (Describ,Dbuf2,elcount(Describ));
  }
  else Re=-1;
  State_TIME_=getValue(StateMachine_TIME);
  return Re;
}

long ANetT_Test_LINChecksum_Enhanced(char Path[],dword StandardID[],char Describ[])
{
  char Sbuf[1000];
  char Dbuf1[1000];
  char Dbuf2[1000];
  char Dbuf3[1000];
  char StandardIDTemp[10];
  long Re=0;
  int i=0;
  int j=0;
  char absPath[1000];
  getAbsFilePath(Path,absPath,1000);
  strncpy(Sbuf,"",elCount(Sbuf));
  strncat(Sbuf,"ANetT_Test_LINChecksum_Enhanced@",elCount(Sbuf));
  strncat(Sbuf,absPath,elCount(Sbuf));
  strncat(Sbuf,"@",elCount(Sbuf));
  for(i=0;i<500;i++)
  {
    if(StandardID[i]=='\0') break;
    ltoa(StandardID[i],StandardIDTemp,16);
    strncat(Sbuf,StandardIDTemp,elCount(Sbuf));
    strncat(Sbuf,"#",elCount(Sbuf));
  }
  strncat(Sbuf,"@",elCount(Sbuf));
  write("Sbuf====:%s",Sbuf);
  putValue(CAPL_String,Sbuf);
  testWaitForTimeout(1);
  putValue(CAPL_TIME,timeNow());
  while(1)
  {
    if(getValue(StateMachine_TIME)!=State_TIME_)
    {
      getValue(StateMachine_String,State_String_);
      break;
    }
    testWaitForTimeout(1);
  }
  k1=strstr_off(State_String_,0,"@");
  k2=strstr_off(State_String_,k1+1,"@");
  if(k1>0&&k2>0)
  {
    substr_cpy(Dbuf1,State_String_,0,k1,elCount(Dbuf1));
    substr_cpy(Dbuf2,State_String_,k1+1,k2-k1-1,elCount(Dbuf2));
    write("Dbuf2====:%s",Dbuf2);
    Re=atol(Dbuf1);
    strncpy (Describ,Dbuf2,elcount(Describ));
  }
  else Re=-1;
  State_TIME_=getValue(StateMachine_TIME);
  return Re;
}




long ANetT_Test_LINBitLevel(char Path[],long Mode, float Timebase,float Baudrate,long SampPoint,long Level,float &CurSorA,float &CursorB)
{
  char Sbuf[1000];
  char Dbuf1[1000];
  char Dbuf2[1000];
  char Dbuf3[1000];
  char Dbuf4[1000];
  char TimebaseTemp[20];
  char BaudrateTemp[20];
  char ModeTemp[10];
  char SampPointTemp[10];
  char LevelTemp[10];
  float Re=0;
  int i=0;
  int j=0;
  char absPath[1000];
  getAbsFilePath(Path,absPath,1000);
  strncpy(Sbuf,"",elCount(Sbuf));
  strncat(Sbuf,"ANetT_Test_LINBitLevel@",elCount(Sbuf));
  strncat(Sbuf,absPath,elCount(Sbuf));
  strncat(Sbuf,"@",elCount(Sbuf));
  ltoa(Mode,ModeTemp,10);
  strncat(Sbuf,ModeTemp,elCount(Sbuf));
  strncat(Sbuf,"@",elCount(Sbuf));
  snprintf(TimebaseTemp,elCount(TimebaseTemp),"%.15f",Timebase);
  strncat(Sbuf,TimebaseTemp,elCount(Sbuf));
  strncat(Sbuf,"@",elCount(Sbuf));
  snprintf(BaudrateTemp,elCount(BaudrateTemp),"%.2f",Baudrate);
  strncat(Sbuf,BaudrateTemp,elCount(Sbuf));
  strncat(Sbuf,"@",elCount(Sbuf));  
  ltoa(SampPoint,SampPointTemp,10);
  strncat(Sbuf,SampPointTemp,elCount(Sbuf));
  strncat(Sbuf,"@",elCount(Sbuf));
  ltoa(Level,LevelTemp,10);
  strncat(Sbuf,LevelTemp,elCount(Sbuf));
  strncat(Sbuf,"@",elCount(Sbuf));
  write("Sbuf==BitLevel==:%s",Sbuf);
  putValue(CAPL_String,Sbuf);
  testWaitForTimeout(1);
  putValue(CAPL_TIME,timeNow());
  while(1)
  {
    if(getValue(StateMachine_TIME)!=State_TIME_)
    {
      getValue(StateMachine_String,State_String_);
      break;
    }
    testWaitForTimeout(1);
  }
  k1=strstr_off(State_String_,0,"@");
  k2=strstr_off(State_String_,k1+1,"@");
  k3=strstr_off(State_String_,k2+1,"@");
    write("State_String_==BitLevel==:%s",State_String_);
  if(k1>0&&k2>0&&k3>0)
  {
    substr_cpy(Dbuf1,State_String_,0,k1,elCount(Dbuf1));
    substr_cpy(Dbuf2,State_String_,k1+1,k2-k1-1,elCount(Dbuf2));
    substr_cpy(Dbuf3,State_String_,k2+1,k3-k2-1,elCount(Dbuf3));
    write("CurSorA==BitLevel==:%s",Dbuf2);
    write("CurSorB==BitLevel==:%s",Dbuf3);
    Re=atodbl(Dbuf1);
    CurSorA=atodbl(Dbuf2);
    CursorB=atodbl(Dbuf3);
  }
  else Re=-1;
  State_TIME_=getValue(StateMachine_TIME);
  return Re;
}

long ANetT_Test_LINDutyRatio(char Path[],long Mode, float Voltage, long SampPoint, float Timebase,   float Baudrate, float &MinVa,float &MinVb , float &MaxVa,float &MaxVb)
{
  char Sbuf[1000];
  char Dbuf1[1000];
  char Dbuf2[1000];
  char Dbuf3[1000];
  char Dbuf4[1000];
  char Dbuf5[1000];
  char TimebaseTemp[20];
  char BaudrateTemp[20];
  char ModeTemp[10];
  char SampPointTemp[10];
  char VoltageTemp[10];
  float Re=0;
  int i=0;
  int j=0;
  char absPath[1000];
  getAbsFilePath(Path,absPath,1000);
  strncpy(Sbuf,"",elCount(Sbuf));
  strncat(Sbuf,"ANetT_Test_LINDutyRatio@",elCount(Sbuf));
  strncat(Sbuf,absPath,elCount(Sbuf));
  strncat(Sbuf,"@",elCount(Sbuf));
  ltoa(Mode,ModeTemp,10);
  strncat(Sbuf,ModeTemp,elCount(Sbuf));
  strncat(Sbuf,"@",elCount(Sbuf));
  snprintf(VoltageTemp,elCount(VoltageTemp),"%.2f",Voltage);
  strncat(Sbuf,VoltageTemp,elCount(Sbuf));
  strncat(Sbuf,"@",elCount(Sbuf));
  ltoa(SampPoint,SampPointTemp,10);
  strncat(Sbuf,SampPointTemp,elCount(Sbuf));
  strncat(Sbuf,"@",elCount(Sbuf));
  snprintf(TimebaseTemp,elCount(TimebaseTemp),"%.2f",Timebase);
  strncat(Sbuf,TimebaseTemp,elCount(Sbuf));
  strncat(Sbuf,"@",elCount(Sbuf));
  snprintf(BaudrateTemp,elCount(BaudrateTemp),"%.2f",Baudrate);
  strncat(Sbuf,BaudrateTemp,elCount(Sbuf));
  strncat(Sbuf,"@",elCount(Sbuf));
  write("Sbuf========%s",Sbuf); 
  putValue(CAPL_String,Sbuf);
  testWaitForTimeout(1);
  putValue(CAPL_TIME,timeNow());
  while(1)
  {
    if(getValue(StateMachine_TIME)!=State_TIME_)
    {
      
      getValue(StateMachine_String,State_String_);
      break;
    }
    testWaitForTimeout(1);
  }
  k1=strstr_off(State_String_,0,"@");
  k2=strstr_off(State_String_,k1+1,"@");
  k3=strstr_off(State_String_,k2+1,"@");
  k4=strstr_off(State_String_,k3+1,"@");
  k5=strstr_off(State_String_,k4+1,"@");
  if(k1>0&&k2>0&&k3>0)
  {
    substr_cpy(Dbuf1,State_String_,0,k1,elCount(Dbuf1));
    substr_cpy(Dbuf2,State_String_,k1+1,k2-k1-1,elCount(Dbuf2));
    substr_cpy(Dbuf3,State_String_,k2+1,k3-k2-1,elCount(Dbuf3));
    substr_cpy(Dbuf4,State_String_,k3+1,k4-k3-1,elCount(Dbuf4));
    substr_cpy(Dbuf5,State_String_,k4+1,k5-k4-1,elCount(Dbuf5));
    Re=atodbl(Dbuf1);
    write("Dbuf1========%s",Dbuf1); 
    MinVa=atodbl(Dbuf2);
    MinVb=atodbl(Dbuf3);
    MaxVa=atodbl(Dbuf4);
    MaxVb=atodbl(Dbuf5);
    write("MinVa==ANetT_Test_LINDutyRatio==:%s",Dbuf2);
    write("MinVb==ANetT_Test_LINDutyRatio==:%s",Dbuf3);
    write("MaxVa==ANetT_Test_LINDutyRatio==:%s",Dbuf4);
    write("MaxVb==ANetT_Test_LINDutyRatio==:%s",Dbuf5);
  }
  else Re=-1;
  State_TIME_=getValue(StateMachine_TIME);
  return Re;
}

long ANetT_Test_LINBaudrate(char Path[],long Mode, float Voltage,long Timebase,long SampPoint,float Baudrate,float &CurSorA,float &CursorB)
{
  char Sbuf[1000];
  char Dbuf1[1000];
  char Dbuf2[1000];
  char Dbuf3[1000];
  char TimebaseTemp[20];
  char BaudrateTemp[20];
  char ModeTemp[10];
  char SampPointTemp[10];
  char VoltageTemp[10];
  float Re=0;
  int i=0;
  int j=0;
  char absPath[1000];
  getAbsFilePath(Path,absPath,1000);
  strncpy(Sbuf,"",elCount(Sbuf));
  strncat(Sbuf,"ANetT_Test_LINBaudrate@",elCount(Sbuf));
  strncat(Sbuf,absPath,elCount(Sbuf));
  strncat(Sbuf,"@",elCount(Sbuf));
  ltoa(Mode,ModeTemp,10);
  strncat(Sbuf,ModeTemp,elCount(Sbuf));
  strncat(Sbuf,"@",elCount(Sbuf));
  snprintf(VoltageTemp,elCount(VoltageTemp),"%.2f",Voltage);
  strncat(Sbuf,VoltageTemp,elCount(Sbuf));
  strncat(Sbuf,"@",elCount(Sbuf));
  ltoa(Timebase,TimebaseTemp,10);
  strncat(Sbuf,TimebaseTemp,elCount(Sbuf));
  strncat(Sbuf,"@",elCount(Sbuf));
  ltoa(SampPoint,SampPointTemp,10);
  strncat(Sbuf,SampPointTemp,elCount(Sbuf));
  strncat(Sbuf,"@",elCount(Sbuf));
  snprintf(BaudrateTemp,elCount(BaudrateTemp),"%.2f",Baudrate);
  strncat(Sbuf,BaudrateTemp,elCount(Sbuf));
  strncat(Sbuf,"@",elCount(Sbuf));
  write("Sbuf========%s",Sbuf); 
  putValue(CAPL_String,Sbuf);
  testWaitForTimeout(1);
  putValue(CAPL_TIME,timeNow());
  while(1)
  {
    if(getValue(StateMachine_TIME)!=State_TIME_)
    {
      getValue(StateMachine_String,State_String_);
      break;
    }
    testWaitForTimeout(1);
  }
  k1=strstr_off(State_String_,0,"@");
  k2=strstr_off(State_String_,k1+1,"@");
  k3=strstr_off(State_String_,k2+1,"@");
  if(k1>0&&k2>0&&k3>0)
  {
    substr_cpy(Dbuf1,State_String_,0,k1,elCount(Dbuf1));
    substr_cpy(Dbuf2,State_String_,k1+1,k2-k1-1,elCount(Dbuf2));
    substr_cpy(Dbuf3,State_String_,k2+1,k3-k2-1,elCount(Dbuf3));
    Re=atodbl(Dbuf1);
    CurSorA=atodbl(Dbuf2);
    CursorB=atodbl(Dbuf3);
    write("CurSorA==ANetT_Test_LINBaudrate==:%s",Dbuf2);
    write("CurSorB==ANetT_Test_LINBaudrate==:%s",Dbuf3);
  }
  else Re=-1;
  State_TIME_=getValue(StateMachine_TIME);
  return Re;
}

long ANetT_Test_LINlength(char Path[],long Mode, float Voltage,float Timebase,long SampPoint,float Baudrate,float &CurSorA,float &CursorB)
{
  char Sbuf[1000];
  char Dbuf1[1000];
  char Dbuf2[1000];
  char Dbuf3[1000];
  char TimebaseTemp[20];
  char BaudrateTemp[20];
  char ModeTemp[10];
  char SampPointTemp[10];
  char VoltageTemp[10];
  float Re=0;
  int i=0;
  int j=0;
  char absPath[1000];
  getAbsFilePath(Path,absPath,1000);
  strncpy(Sbuf,"",elCount(Sbuf));
  strncat(Sbuf,"ANetT_Test_LINlength@",elCount(Sbuf));
  strncat(Sbuf,absPath,elCount(Sbuf));
  strncat(Sbuf,"@",elCount(Sbuf));
  ltoa(Mode,ModeTemp,10);
  strncat(Sbuf,ModeTemp,elCount(Sbuf));
  strncat(Sbuf,"@",elCount(Sbuf));
  snprintf(VoltageTemp,elCount(VoltageTemp),"%.2f",Voltage);
  strncat(Sbuf,VoltageTemp,elCount(Sbuf));
  strncat(Sbuf,"@",elCount(Sbuf));
  snprintf(TimebaseTemp,elCount(TimebaseTemp),"%.2f",Timebase);
  strncat(Sbuf,TimebaseTemp,elCount(Sbuf));
  strncat(Sbuf,"@",elCount(Sbuf));
  ltoa(SampPoint,SampPointTemp,10);
  strncat(Sbuf,SampPointTemp,elCount(Sbuf));
  strncat(Sbuf,"@",elCount(Sbuf));
  snprintf(BaudrateTemp,elCount(BaudrateTemp),"%.2f",Baudrate);
  strncat(Sbuf,BaudrateTemp,elCount(Sbuf));
  strncat(Sbuf,"@",elCount(Sbuf));
  write("Sbuf========%s",Sbuf); 
  putValue(CAPL_String,Sbuf);
  testWaitForTimeout(1);
  putValue(CAPL_TIME,timeNow());
  while(1)
  {
    if(getValue(StateMachine_TIME)!=State_TIME_)
    {
      getValue(StateMachine_String,State_String_);
      break;
    }
    testWaitForTimeout(1);
  }
  k1=strstr_off(State_String_,0,"@");
  k2=strstr_off(State_String_,k1+1,"@");
  k3=strstr_off(State_String_,k2+1,"@");
  if(k1>0&&k2>0&&k3>0)
  {
    substr_cpy(Dbuf1,State_String_,0,k1,elCount(Dbuf1));
    substr_cpy(Dbuf2,State_String_,k1+1,k2-k1-1,elCount(Dbuf2));
    substr_cpy(Dbuf3,State_String_,k2+1,k3-k2-1,elCount(Dbuf3));
    Re=atodbl(Dbuf1);
    CurSorA=atodbl(Dbuf2);
    CursorB=atodbl(Dbuf3);
    write("CurSorA==ANetT_Test_LINlength==:%s",Dbuf2);
    write("CurSorB==ANetT_Test_LINlength==:%s",Dbuf3);
  }
  else Re=-1;
  State_TIME_=getValue(StateMachine_TIME);
  return Re;
}
