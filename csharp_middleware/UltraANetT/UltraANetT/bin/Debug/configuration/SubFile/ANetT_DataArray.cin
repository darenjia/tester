/*@!Encoding:936*/
void MaxOrMin(int ArraySize,long Data[],int mod,int& WorstNum)//最差值
{
  int i;
  float wrost;
  
  wrost=Data[0];
  WorstNum=0;
  if(mod==0)//最小值
  {
    WorstNum=0;
    for(i=0;i<ArraySize;i++)
    {
     if(wrost>Data[i])
     {
      wrost=Data[i];
      WorstNum=i;
     }
    }
  }
  else if(mod==1)//最大值
  {
    WorstNum=0;
    for(i=0;i<ArraySize;i++)
    {
     if(wrost<Data[i])
     {
      wrost=Data[i];
      WorstNum=i;
     }
    }
  }
}

void ArrayInital(dword array[],int size)

{
  int a;
  a=0;
  do
  {
    array[a]=0;
    a++;
    
  }while(a<size);
}

void ArrayInital(long array[],int size)

{
  int a;
  a=0;
  do
  {
    array[a]=0;
    a++;
    
  }while(a<size);
}

int Search1DArray(dword array[],dword element)
{
  int  i,Nummax,Num,state;
  int Serial; 

  Num=0;
  Nummax=0;
  state=0;
  Serial=0;

  while(1)
  {
    if(state==1)
    break;
    else
    {
      Nummax=Nummax+100;
      for(i=0;i<Nummax;i++)
      {
        if(array[i]==0)
        { Num=i;state=1;break;}
      }
    }
  }
  if(Num==0)
  Serial=-1;
  else
  Serial=999; 
  
  for(i=0;i<Num;i++)
  {
    if(element==array[i])
    { Serial=i;break;}    
  }
  
  return Serial;
}

int AddArray(dword array[],dword element)
{
  int i;
  i=0;
  while(1)
  { 
    if(array[i]==0 || i>5000) break;
    i++;
  }
  array[i]=element;
  i++;
  return i;
}

int AddArray(long array[],long element)
{
  int i;
  i=0;
  while(1)
  {
    if(array[i]==0||i>5000) break;
    i++;
  }
  array[i]=element;
  i++;
  return i;
}

void DisturbSynicBit(dword DisturbID,int Position)//Position=1 干扰指定ID  Position=0 干扰下一个ID
{
  if(Position==1)
  {
//    write("DisturbID111111111=====%x",DisturbID);
//    DisturbID = linGetProtectedID(DisturbID);
//    write("DisturbID222222222=====%x",DisturbID);
//    linSendHeaderError(0x0, DisturbID, 0);
    linInvertHeaderBit(0, 0, 0, 1);        
  }/*--------同步场错误测试 改变同步场---------*/
  else
  {
    linInvertHeaderBit(0, 8, 0, 1);
  }/*--------同步场错误测试 改变同步场结束位---------*/
}

void DisturbID_P0P1(dword DisturbID)
{
  dword byteIndices[2];
  dword bitIndices[2];
  dword numberOfDisturbedBits[2];
  dword levels[2];
  dword arrSize;
  dword byte2;
  
  byteIndices[0]=1;byteIndices[1]=1;
  bitIndices[0]=6;bitIndices[1]=7;
  numberOfDisturbedBits[0]=1;numberOfDisturbedBits[1]=1;
  levels[0]=1;levels[1]=1;
  arrSize=2;
  write("111111111=====%x",DisturbID);
  
  byte2=DisturbID^0xFF;
  byte2=byte2>>6; 
  write("-----1=====%x",byte2);
  levels[0]=byte2&0x01;
  levels[1]=byte2>>1;
  levels[1]=levels[1]&0x01;
  write("000=====%x",levels[0]);write("1111=====%x",levels[1]);
  
  linInvertMultipleHeaderBits(byteIndices, bitIndices, numberOfDisturbedBits, levels,arrSize); //,1,0x18,0 //1为干扰次数，0x18为干扰之前的ID，0为等待几个报文头
//    linInvertMultipleHeaderBits(1,1,1,4,0);
  }

void Disturb_Checksum_DLC(dword DisturbID,byte DisturbID_DLC,byte byte0,int flag) //flag==1 Checksum干扰  flag==2 数据场干扰  flag==3 数据场结束位干扰 
{
  
  dword byteIndices[8]={8,8,8,8,8,8,8,8};
  dword bitIndices[8]={0,1,2,3,4,5,6,7};
  dword numberOfDisturbedBits[8]={1,1,1,1,1,1,1,1};
  byte  levels[8]={0,0,0,0,0,0,0,0};
  dword arrSize=8; 
  int  i;
  if(flag==1)
   // linInvertRespBit (DisturbID, DisturbID_DLC,  7);  
  linDisturbRespWithBitStream(DisturbID, DisturbID_DLC, 0,levels, 8,1);   //ID  字节长度   从第几位开始  
  if(flag==2)
  {
//    byte0=byte0<<7;
//    write("byte0=====%x",byte0);
//    byte0=byte0^0xFF;
//    write("~byte0=====%x",byte0);
    for(i=0;i<8;i++)
    {
      if((byte0>>i) & 0x1 == 1)
      { 
        write("i=====%d",i);
        break;
      }
      
    }
    //linInvertRespBit (DisturbID, 0,  DisturbID_DLC,byte0,1);    //(Msg.id, 0,  长度,byte0,1)      
    linInvertRespBit (DisturbID, 0,  i, 0 ,1);    //
  }
  if(flag==3)
  linInvertRespBit (DisturbID, DisturbID_DLC-1, 8,0,1);
}
